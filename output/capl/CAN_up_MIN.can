
/**********************************************************************************************************************
*  FILE DESCRIPTION
* -------------------------------------------------------------------------------------------------------------------
*             File       : CAPL_Generator.can
*			       Release    : 1.0  
*             Author     : Rushikesh v. Jadhav
*             Date       : 10/12/2023 
*             Description: This CAPL script is used to check minimum,,medium and maximum values of signal.
*                           and also generate log report as a test result.
*********************************************************************************************************************/

/**************************************************[Include definitions]*********************************************/


/* @!Encoding:1252 */
includes
{


}
    
/**************************************************[Variable definitions]*********************************************/

variables
{

/* Declaration of variable for diagnostics request and response */   
message `UDS_REQ_FAA_FL Request;              /* For Request */ 
message `UDS_RESP_FAA_FL response;            /* For Response */               
    

/* Declaration for Diagnostics request global variable */
int flag         = 1;        /* Initialy it should be -> 1 (Without any response  we need to send 1st request ) */                              
int dealy_flag   = 0; 
int test_suit    = 0;   
int test_case    = 0;
int actual_value = 0;
int size_dlc     = 0x0B;     /* DLC = Service Identifier + Data Identifier + 10 bytes of Data */   
int SID_NO       = 0x2E;     /* Service Identifier */                         
int DID_NO_h     = 0x02;     /* DID number = 0x0200 */    
int DID_NO_f     = 0x00;
    
    

/* Declaration variable for csv file */
int len,i,j      = 0 ;    
int values[486];              /* In this array we store int value of .csv file ( neglecting [by using CAPL code] other string parameter) */ 
char buffer [567];            /* As a  string  we read .csv file and store in this array */ 
int arrayIndex   = 0;
int temp         = 0;
dword glbHandle;
int arraySize;


/**********************************************************************************************************************
* Read message name and then create a global variable by using prefix( _var) @end: 
* Before :  ASMC_25HZ_ST_REQ_FAA
* After  : ASMC_25HZ_ST_REQ_FAA_var  
**********************************************************************************************************************/

    
message ASMC_25HZ_ST_REQ_FAA ASMC_25HZ_ST_REQ_FAA_var ;                                                    
int Asmc_Req_DaHlthTest_Na_var = 0;
int Ascc_St_Req_Na_var = 0;
int Asmc_25Hz_Sts_AlvCtr_var = 0;

message ASMC_100HZ_STATY_ST_REQ_FAA ASMC_100HZ_STATY_ST_REQ_FAA_var ;                                                    
int Fas_Sts_VehStsSpdLo_Qfr_Na_var = 0;
int Fas_Sts_VehSpdLo_Na_var = 0;
int Fas_Sts_VehStsStaty_Qfr_Na_var = 0;
int Fas_Sts_VehStaty_Na_var = 0;
int Asmc_100Hz_Sts_VehStaty_Crc_var = 0;
int Asmc_100Hz_Sts_VehStaty_AlvCtr_var = 0;

message ASMC_1000HZ_F_CMD_FAA ASMC_1000HZ_F_CMD_FAA_var ;                                                    
int Faa_Sts_F_Qfr_Na_var = 0;
int Faa_F_Rr_AtActr_Cmd_Nwt_var = 0;
int Faa_F_Rl_AtActr_Cmd_Nwt_var = 0;
int Faa_F_Fr_AtActr_Cmd_Nwt_var = 0;
int Faa_F_Fl_AtActr_Cmd_Nwt_var = 0;
int Asmc_1000Hz_F_Cmd_Crc_var = 0;
int Asmc_1000Hz_F_Cmd_AlvCtr_var = 0;

message ASMC_100HZ_ZL_MOFR_FAA ASMC_100HZ_ZL_MOFR_FAA_var ;                                                    
int Faa_Sts_ZlMofr_Re_Qfr_Na_var = 0;
int Faa_Gain_Re_ZlFil_Na_var = 0;
int Faa_Wi_Re_ZlFil_Na_var = 0;
int Faa_Frq_Re_ZlFil_Ce_Hz_var = 0;
int Faa_Mofr_Re_ZlGain_Na_var = 0;
int Faa_Sts_ZlMofr_Fn_Qfr_Na_var = 0;
int Faa_Gain_Fn_ZlFil_Na_var = 0;
int Faa_Wi_Fn_ZlFil_Na_var = 0;
int Faa_Frq_Fn_ZlFil_Ce_Hz_var = 0;
int Faa_Mofr_Fn_ZlGain_Na_var = 0;
int Asmc_100Hz_Zl_Mofr_AlvCtr_var = 0;


/* Timer declaration for cyclic messages and timer Delay variable is configured based on msg cyclic time */  
    
msTimer _timer1;                                     
float timer_delay1 =1;
    

msTimer _timer10;                                     
float timer_delay10 =10;
    

msTimer _timer40;                                     
float timer_delay40 =40;
    

/* Declaration  of timer for loop creation */ 
msTimer _timercheck;
int timer_delay = 1;
    
}
    
on start
{
/* Print statments */   
write(" CAPL FILE READY TO -> -START ");
write(" PRESS -> d  FOR TO RUN TEST CASE AND TEST SUIT ");  


/* Set timer for cyclic message */  
    setTimer(_timer1,timer_delay1); 
    
setTimer(_timer10,timer_delay10); 
    
setTimer(_timer40,timer_delay40); 
    
   

/**********************************************************************************************************************
* CSV file -> Convert char to int value by neglecting unwanted characters: 
* Before :  1,2,3,4,
* After  :  0 1 2 3 4  
**********************************************************************************************************************/

/* Note : Read both the files : .csv & CANalyzer .config file and both should be in same folder */
glbHandle = OpenFileRead ("NEW_file.csv",0);  


/* Check file is found or not */                 
if(glbHandle != 0)
{
    fileGetString(buffer,elcount(buffer),glbHandle);
    /* File found */
    write(" file(CSV) found ");
    arrayIndex = 0;
    temp = 0;
    len  = strlen(buffer);
    for ( i = 0; i < len; i++) 
    {
        if (buffer[i] >= '0' && buffer[i] <= '9') {         /* It take only int values */
        temp = temp * 10 + (buffer[i] - '0');
        }
        else if (buffer[i] == ',') {                        /* Remove ',' */ 
        values[arrayIndex++] = temp;
        temp = 0;
        }
    }
    values[arrayIndex] = temp;                             /* Final Int Array */
        
}
else{
write(" file(CSV) not found");
}
    
}
    
/* On timer event implementation to send periodic message on CAN  Bus */
    on timer _timer1
{
    setTimer(_timer1,timer_delay1); 
    
    ASMC_1000HZ_F_CMD_FAA_var.Faa_Sts_F_Qfr_Na =  Faa_Sts_F_Qfr_Na_var;  
    
    ASMC_1000HZ_F_CMD_FAA_var.Faa_F_Rr_AtActr_Cmd_Nwt =  Faa_F_Rr_AtActr_Cmd_Nwt_var;  
    
    ASMC_1000HZ_F_CMD_FAA_var.Faa_F_Rl_AtActr_Cmd_Nwt =  Faa_F_Rl_AtActr_Cmd_Nwt_var;  
    
    ASMC_1000HZ_F_CMD_FAA_var.Faa_F_Fr_AtActr_Cmd_Nwt =  Faa_F_Fr_AtActr_Cmd_Nwt_var;  
    
    ASMC_1000HZ_F_CMD_FAA_var.Faa_F_Fl_AtActr_Cmd_Nwt =  Faa_F_Fl_AtActr_Cmd_Nwt_var;  
    
    ASMC_1000HZ_F_CMD_FAA_var.Asmc_1000Hz_F_Cmd_Crc =  Asmc_1000Hz_F_Cmd_Crc_var;  
    
    ASMC_1000HZ_F_CMD_FAA_var.Asmc_1000Hz_F_Cmd_AlvCtr =  Asmc_1000Hz_F_Cmd_AlvCtr_var;  
    
    output(ASMC_1000HZ_F_CMD_FAA_var); 
    
}
    on timer _timer10
{
    setTimer(_timer10,timer_delay10); 
    
    ASMC_100HZ_STATY_ST_REQ_FAA_var.Fas_Sts_VehStsSpdLo_Qfr_Na =  Fas_Sts_VehStsSpdLo_Qfr_Na_var;  
    
    ASMC_100HZ_STATY_ST_REQ_FAA_var.Fas_Sts_VehSpdLo_Na =  Fas_Sts_VehSpdLo_Na_var;  
    
    ASMC_100HZ_STATY_ST_REQ_FAA_var.Fas_Sts_VehStsStaty_Qfr_Na =  Fas_Sts_VehStsStaty_Qfr_Na_var;  
    
    ASMC_100HZ_STATY_ST_REQ_FAA_var.Fas_Sts_VehStaty_Na =  Fas_Sts_VehStaty_Na_var;  
    
    ASMC_100HZ_STATY_ST_REQ_FAA_var.Asmc_100Hz_Sts_VehStaty_Crc =  Asmc_100Hz_Sts_VehStaty_Crc_var;  
    
    ASMC_100HZ_STATY_ST_REQ_FAA_var.Asmc_100Hz_Sts_VehStaty_AlvCtr =  Asmc_100Hz_Sts_VehStaty_AlvCtr_var;  
    
    output(ASMC_100HZ_STATY_ST_REQ_FAA_var); 
    
    ASMC_100HZ_ZL_MOFR_FAA_var.Faa_Sts_ZlMofr_Re_Qfr_Na =  Faa_Sts_ZlMofr_Re_Qfr_Na_var;  
    
    ASMC_100HZ_ZL_MOFR_FAA_var.Faa_Gain_Re_ZlFil_Na =  Faa_Gain_Re_ZlFil_Na_var;  
    
    ASMC_100HZ_ZL_MOFR_FAA_var.Faa_Wi_Re_ZlFil_Na =  Faa_Wi_Re_ZlFil_Na_var;  
    
    ASMC_100HZ_ZL_MOFR_FAA_var.Faa_Frq_Re_ZlFil_Ce_Hz =  Faa_Frq_Re_ZlFil_Ce_Hz_var;  
    
    ASMC_100HZ_ZL_MOFR_FAA_var.Faa_Mofr_Re_ZlGain_Na =  Faa_Mofr_Re_ZlGain_Na_var;  
    
    ASMC_100HZ_ZL_MOFR_FAA_var.Faa_Sts_ZlMofr_Fn_Qfr_Na =  Faa_Sts_ZlMofr_Fn_Qfr_Na_var;  
    
    ASMC_100HZ_ZL_MOFR_FAA_var.Faa_Gain_Fn_ZlFil_Na =  Faa_Gain_Fn_ZlFil_Na_var;  
    
    ASMC_100HZ_ZL_MOFR_FAA_var.Faa_Wi_Fn_ZlFil_Na =  Faa_Wi_Fn_ZlFil_Na_var;  
    
    ASMC_100HZ_ZL_MOFR_FAA_var.Faa_Frq_Fn_ZlFil_Ce_Hz =  Faa_Frq_Fn_ZlFil_Ce_Hz_var;  
    
    ASMC_100HZ_ZL_MOFR_FAA_var.Faa_Mofr_Fn_ZlGain_Na =  Faa_Mofr_Fn_ZlGain_Na_var;  
    
    ASMC_100HZ_ZL_MOFR_FAA_var.Asmc_100Hz_Zl_Mofr_AlvCtr =  Asmc_100Hz_Zl_Mofr_AlvCtr_var;  
    
    output(ASMC_100HZ_ZL_MOFR_FAA_var); 
    
}
    on timer _timer40
{
    setTimer(_timer40,timer_delay40); 
    
    ASMC_25HZ_ST_REQ_FAA_var.Asmc_Req_DaHlthTest_Na =  Asmc_Req_DaHlthTest_Na_var;  
    
    ASMC_25HZ_ST_REQ_FAA_var.Ascc_St_Req_Na =  Ascc_St_Req_Na_var;  
    
    ASMC_25HZ_ST_REQ_FAA_var.Asmc_25Hz_Sts_AlvCtr =  Asmc_25Hz_Sts_AlvCtr_var;  
    
    output(ASMC_25HZ_ST_REQ_FAA_var); 
    
}
    
/* On key event start */

on key 'd'
{
write(" KEY ->  d IS PRESSED ");  
setTimer(_timercheck,timer_delay);      
}

/* On timer start */
    
on timer _timercheck
{

/* Timer is set again to create a loop */    
setTimer(_timercheck,timer_delay);                                      

/* Array end  @99 value, j variable is used for array increment */  
if(values[j] != 99)                                
{
/* Check test suit number */
switch (values[j]) {
    
    case(0) :
        /* Check test case inside the test suit */                                                                                         
        switch(values[j+1]){
        
    
            case(0) :                                                                               
    
                    if(flag == 1)                                                        
                        {  
                            flag = 0;
                                                
                            Asmc_Req_DaHlthTest_Na_var = ((0/1.0)-0.0); 

                            ASMC_25HZ_ST_REQ_FAA_var.Asmc_Req_DaHlthTest_Na =  Asmc_Req_DaHlthTest_Na_var;  
                            
                            output(ASMC_25HZ_ST_REQ_FAA_var);                                      
                                            
                                                
                            test_suit    = 0;
                            test_case    = 0;
                            actual_value = ((0/1.0)-0.0);
                            
                            write("test suit = %d, test case = %d,",test_suit,test_case); 
                                            
                            Request.dlc = 8;                                                     /* CAN Frame DLC */
                            Request.byte(0) = 0x10;                                              /* FF frame */
                            Request.byte(1) = size_dlc;                                          /* Total length of request message -> DID length + SID + DID  = 0B */ 
                            Request.byte(2) = SID_NO;                                            /* SID = 2E */  
                            Request.byte(3) = DID_NO_h;                                          /* DID Number Byte 1 = 0x00 */                        
                            Request.byte(4) = DID_NO_f;                                          /* DID Number Byte 2 = 0x00 */ 
                            Request.byte(5) =  test_suit;                                        /* Test Suite Number  - B0 */
                            Request.byte(6) =  test_case;                                        /* Test Case Number - B1 */
                            Request.byte(7) =  actual_value;                                     /* Test value needed for the test - Min, Mid, Max - B2 */
                                                
                                            
                            output(Request);                                 
                                                
                        }
                        break;
    
            case(1) :                                                                               
    
                    if(flag == 1)                                                        
                        {  
                            flag = 0;
                                                
                            Asmc_Req_DaHlthTest_Na_var = ((1/1.0)-0.0); 

                            ASMC_25HZ_ST_REQ_FAA_var.Asmc_Req_DaHlthTest_Na =  Asmc_Req_DaHlthTest_Na_var;  
                            
                            output(ASMC_25HZ_ST_REQ_FAA_var);                                      
                                            
                                                
                            test_suit    = 0;
                            test_case    = 1;
                            actual_value = ((1/1.0)-0.0);
                            
                            write("test suit = %d, test case = %d,",test_suit,test_case); 
                                            
                            Request.dlc = 8;                                                     /* CAN Frame DLC */
                            Request.byte(0) = 0x10;                                              /* FF frame */
                            Request.byte(1) = size_dlc;                                          /* Total length of request message -> DID length + SID + DID  = 0B */ 
                            Request.byte(2) = SID_NO;                                            /* SID = 2E */  
                            Request.byte(3) = DID_NO_h;                                          /* DID Number Byte 1 = 0x00 */                        
                            Request.byte(4) = DID_NO_f;                                          /* DID Number Byte 2 = 0x00 */ 
                            Request.byte(5) =  test_suit;                                        /* Test Suite Number  - B0 */
                            Request.byte(6) =  test_case;                                        /* Test Case Number - B1 */
                            Request.byte(7) =  actual_value;                                     /* Test value needed for the test - Min, Mid, Max - B2 */
                                                
                                            
                            output(Request);                                 
                                                
                        }
                        break;
    
            case(2) :                                                                               
    
                    if(flag == 1)                                                        
                        {  
                            flag = 0;
                                                
                            Asmc_Req_DaHlthTest_Na_var = ((2/1.0)-0.0); 

                            ASMC_25HZ_ST_REQ_FAA_var.Asmc_Req_DaHlthTest_Na =  Asmc_Req_DaHlthTest_Na_var;  
                            
                            output(ASMC_25HZ_ST_REQ_FAA_var);                                      
                                            
                                                
                            test_suit    = 0;
                            test_case    = 2;
                            actual_value = ((2/1.0)-0.0);
                            
                            write("test suit = %d, test case = %d,",test_suit,test_case); 
                                            
                            Request.dlc = 8;                                                     /* CAN Frame DLC */
                            Request.byte(0) = 0x10;                                              /* FF frame */
                            Request.byte(1) = size_dlc;                                          /* Total length of request message -> DID length + SID + DID  = 0B */ 
                            Request.byte(2) = SID_NO;                                            /* SID = 2E */  
                            Request.byte(3) = DID_NO_h;                                          /* DID Number Byte 1 = 0x00 */                        
                            Request.byte(4) = DID_NO_f;                                          /* DID Number Byte 2 = 0x00 */ 
                            Request.byte(5) =  test_suit;                                        /* Test Suite Number  - B0 */
                            Request.byte(6) =  test_case;                                        /* Test Case Number - B1 */
                            Request.byte(7) =  actual_value;                                     /* Test value needed for the test - Min, Mid, Max - B2 */
                                                
                                            
                            output(Request);                                 
                                                
                        }
                        break;
    
            case(3) :                                                                               
    
                    if(flag == 1)                                                        
                        {  
                            flag = 0;
                                                
                            Ascc_St_Req_Na_var = ((0/1.0)-0.0); 

                            ASMC_25HZ_ST_REQ_FAA_var.Ascc_St_Req_Na =  Ascc_St_Req_Na_var;  
                            
                            output(ASMC_25HZ_ST_REQ_FAA_var);                                      
                                            
                                                
                            test_suit    = 0;
                            test_case    = 3;
                            actual_value = ((0/1.0)-0.0);
                            
                            write("test suit = %d, test case = %d,",test_suit,test_case); 
                                            
                            Request.dlc = 8;                                                     /* CAN Frame DLC */
                            Request.byte(0) = 0x10;                                              /* FF frame */
                            Request.byte(1) = size_dlc;                                          /* Total length of request message -> DID length + SID + DID  = 0B */ 
                            Request.byte(2) = SID_NO;                                            /* SID = 2E */  
                            Request.byte(3) = DID_NO_h;                                          /* DID Number Byte 1 = 0x00 */                        
                            Request.byte(4) = DID_NO_f;                                          /* DID Number Byte 2 = 0x00 */ 
                            Request.byte(5) =  test_suit;                                        /* Test Suite Number  - B0 */
                            Request.byte(6) =  test_case;                                        /* Test Case Number - B1 */
                            Request.byte(7) =  actual_value;                                     /* Test value needed for the test - Min, Mid, Max - B2 */
                                                
                                            
                            output(Request);                                 
                                                
                        }
                        break;
    
            case(4) :                                                                               
    
                    if(flag == 1)                                                        
                        {  
                            flag = 0;
                                                
                            Ascc_St_Req_Na_var = ((1/1.0)-0.0); 

                            ASMC_25HZ_ST_REQ_FAA_var.Ascc_St_Req_Na =  Ascc_St_Req_Na_var;  
                            
                            output(ASMC_25HZ_ST_REQ_FAA_var);                                      
                                            
                                                
                            test_suit    = 0;
                            test_case    = 4;
                            actual_value = ((1/1.0)-0.0);
                            
                            write("test suit = %d, test case = %d,",test_suit,test_case); 
                                            
                            Request.dlc = 8;                                                     /* CAN Frame DLC */
                            Request.byte(0) = 0x10;                                              /* FF frame */
                            Request.byte(1) = size_dlc;                                          /* Total length of request message -> DID length + SID + DID  = 0B */ 
                            Request.byte(2) = SID_NO;                                            /* SID = 2E */  
                            Request.byte(3) = DID_NO_h;                                          /* DID Number Byte 1 = 0x00 */                        
                            Request.byte(4) = DID_NO_f;                                          /* DID Number Byte 2 = 0x00 */ 
                            Request.byte(5) =  test_suit;                                        /* Test Suite Number  - B0 */
                            Request.byte(6) =  test_case;                                        /* Test Case Number - B1 */
                            Request.byte(7) =  actual_value;                                     /* Test value needed for the test - Min, Mid, Max - B2 */
                                                
                                            
                            output(Request);                                 
                                                
                        }
                        break;
    
            case(5) :                                                                               
    
                    if(flag == 1)                                                        
                        {  
                            flag = 0;
                                                
                            Ascc_St_Req_Na_var = ((2/1.0)-0.0); 

                            ASMC_25HZ_ST_REQ_FAA_var.Ascc_St_Req_Na =  Ascc_St_Req_Na_var;  
                            
                            output(ASMC_25HZ_ST_REQ_FAA_var);                                      
                                            
                                                
                            test_suit    = 0;
                            test_case    = 5;
                            actual_value = ((2/1.0)-0.0);
                            
                            write("test suit = %d, test case = %d,",test_suit,test_case); 
                                            
                            Request.dlc = 8;                                                     /* CAN Frame DLC */
                            Request.byte(0) = 0x10;                                              /* FF frame */
                            Request.byte(1) = size_dlc;                                          /* Total length of request message -> DID length + SID + DID  = 0B */ 
                            Request.byte(2) = SID_NO;                                            /* SID = 2E */  
                            Request.byte(3) = DID_NO_h;                                          /* DID Number Byte 1 = 0x00 */                        
                            Request.byte(4) = DID_NO_f;                                          /* DID Number Byte 2 = 0x00 */ 
                            Request.byte(5) =  test_suit;                                        /* Test Suite Number  - B0 */
                            Request.byte(6) =  test_case;                                        /* Test Case Number - B1 */
                            Request.byte(7) =  actual_value;                                     /* Test value needed for the test - Min, Mid, Max - B2 */
                                                
                                            
                            output(Request);                                 
                                                
                        }
                        break;
    
            case(6) :                                                                               
    
                    if(flag == 1)                                                        
                        {  
                            flag = 0;
                                                
                            Asmc_25Hz_Sts_AlvCtr_var = ((0/1.0)-0.0); 

                            ASMC_25HZ_ST_REQ_FAA_var.Asmc_25Hz_Sts_AlvCtr =  Asmc_25Hz_Sts_AlvCtr_var;  
                            
                            output(ASMC_25HZ_ST_REQ_FAA_var);                                      
                                            
                                                
                            test_suit    = 0;
                            test_case    = 6;
                            actual_value = ((0/1.0)-0.0);
                            
                            write("test suit = %d, test case = %d,",test_suit,test_case); 
                                            
                            Request.dlc = 8;                                                     /* CAN Frame DLC */
                            Request.byte(0) = 0x10;                                              /* FF frame */
                            Request.byte(1) = size_dlc;                                          /* Total length of request message -> DID length + SID + DID  = 0B */ 
                            Request.byte(2) = SID_NO;                                            /* SID = 2E */  
                            Request.byte(3) = DID_NO_h;                                          /* DID Number Byte 1 = 0x00 */                        
                            Request.byte(4) = DID_NO_f;                                          /* DID Number Byte 2 = 0x00 */ 
                            Request.byte(5) =  test_suit;                                        /* Test Suite Number  - B0 */
                            Request.byte(6) =  test_case;                                        /* Test Case Number - B1 */
                            Request.byte(7) =  actual_value;                                     /* Test value needed for the test - Min, Mid, Max - B2 */
                                                
                                            
                            output(Request);                                 
                                                
                        }
                        break;
    
            case(7) :                                                                               
    
                    if(flag == 1)                                                        
                        {  
                            flag = 0;
                                                
                            Asmc_25Hz_Sts_AlvCtr_var = ((7/1.0)-0.0); 

                            ASMC_25HZ_ST_REQ_FAA_var.Asmc_25Hz_Sts_AlvCtr =  Asmc_25Hz_Sts_AlvCtr_var;  
                            
                            output(ASMC_25HZ_ST_REQ_FAA_var);                                      
                                            
                                                
                            test_suit    = 0;
                            test_case    = 7;
                            actual_value = ((7/1.0)-0.0);
                            
                            write("test suit = %d, test case = %d,",test_suit,test_case); 
                                            
                            Request.dlc = 8;                                                     /* CAN Frame DLC */
                            Request.byte(0) = 0x10;                                              /* FF frame */
                            Request.byte(1) = size_dlc;                                          /* Total length of request message -> DID length + SID + DID  = 0B */ 
                            Request.byte(2) = SID_NO;                                            /* SID = 2E */  
                            Request.byte(3) = DID_NO_h;                                          /* DID Number Byte 1 = 0x00 */                        
                            Request.byte(4) = DID_NO_f;                                          /* DID Number Byte 2 = 0x00 */ 
                            Request.byte(5) =  test_suit;                                        /* Test Suite Number  - B0 */
                            Request.byte(6) =  test_case;                                        /* Test Case Number - B1 */
                            Request.byte(7) =  actual_value;                                     /* Test value needed for the test - Min, Mid, Max - B2 */
                                                
                                            
                            output(Request);                                 
                                                
                        }
                        break;
    
            case(8) :                                                                               
    
                    if(flag == 1)                                                        
                        {  
                            flag = 0;
                                                
                            Asmc_25Hz_Sts_AlvCtr_var = ((14/1.0)-0.0); 

                            ASMC_25HZ_ST_REQ_FAA_var.Asmc_25Hz_Sts_AlvCtr =  Asmc_25Hz_Sts_AlvCtr_var;  
                            
                            output(ASMC_25HZ_ST_REQ_FAA_var);                                      
                                            
                                                
                            test_suit    = 0;
                            test_case    = 8;
                            actual_value = ((14/1.0)-0.0);
                            
                            write("test suit = %d, test case = %d,",test_suit,test_case); 
                                            
                            Request.dlc = 8;                                                     /* CAN Frame DLC */
                            Request.byte(0) = 0x10;                                              /* FF frame */
                            Request.byte(1) = size_dlc;                                          /* Total length of request message -> DID length + SID + DID  = 0B */ 
                            Request.byte(2) = SID_NO;                                            /* SID = 2E */  
                            Request.byte(3) = DID_NO_h;                                          /* DID Number Byte 1 = 0x00 */                        
                            Request.byte(4) = DID_NO_f;                                          /* DID Number Byte 2 = 0x00 */ 
                            Request.byte(5) =  test_suit;                                        /* Test Suite Number  - B0 */
                            Request.byte(6) =  test_case;                                        /* Test Case Number - B1 */
                            Request.byte(7) =  actual_value;                                     /* Test value needed for the test - Min, Mid, Max - B2 */
                                                
                                            
                            output(Request);                                 
                                                
                        }
                        break;
    
            case(9) :                                                                               
    
                    if(flag == 1)                                                        
                        {  
                            flag = 0;
                                                
                            Fas_Sts_VehStsSpdLo_Qfr_Na_var = ((0/1.0)-0.0); 

                            ASMC_100HZ_STATY_ST_REQ_FAA_var.Fas_Sts_VehStsSpdLo_Qfr_Na =  Fas_Sts_VehStsSpdLo_Qfr_Na_var;  
                            
                            output(ASMC_100HZ_STATY_ST_REQ_FAA_var);                                      
                                            
                                                
                            test_suit    = 0;
                            test_case    = 9;
                            actual_value = ((0/1.0)-0.0);
                            
                            write("test suit = %d, test case = %d,",test_suit,test_case); 
                                            
                            Request.dlc = 8;                                                     /* CAN Frame DLC */
                            Request.byte(0) = 0x10;                                              /* FF frame */
                            Request.byte(1) = size_dlc;                                          /* Total length of request message -> DID length + SID + DID  = 0B */ 
                            Request.byte(2) = SID_NO;                                            /* SID = 2E */  
                            Request.byte(3) = DID_NO_h;                                          /* DID Number Byte 1 = 0x00 */                        
                            Request.byte(4) = DID_NO_f;                                          /* DID Number Byte 2 = 0x00 */ 
                            Request.byte(5) =  test_suit;                                        /* Test Suite Number  - B0 */
                            Request.byte(6) =  test_case;                                        /* Test Case Number - B1 */
                            Request.byte(7) =  actual_value;                                     /* Test value needed for the test - Min, Mid, Max - B2 */
                                                
                                            
                            output(Request);                                 
                                                
                        }
                        break;
    
            case(10) :                                                                               
    
                    if(flag == 1)                                                        
                        {  
                            flag = 0;
                                                
                            Fas_Sts_VehStsSpdLo_Qfr_Na_var = ((1/1.0)-0.0); 

                            ASMC_100HZ_STATY_ST_REQ_FAA_var.Fas_Sts_VehStsSpdLo_Qfr_Na =  Fas_Sts_VehStsSpdLo_Qfr_Na_var;  
                            
                            output(ASMC_100HZ_STATY_ST_REQ_FAA_var);                                      
                                            
                                                
                            test_suit    = 0;
                            test_case    = 10;
                            actual_value = ((1/1.0)-0.0);
                            
                            write("test suit = %d, test case = %d,",test_suit,test_case); 
                                            
                            Request.dlc = 8;                                                     /* CAN Frame DLC */
                            Request.byte(0) = 0x10;                                              /* FF frame */
                            Request.byte(1) = size_dlc;                                          /* Total length of request message -> DID length + SID + DID  = 0B */ 
                            Request.byte(2) = SID_NO;                                            /* SID = 2E */  
                            Request.byte(3) = DID_NO_h;                                          /* DID Number Byte 1 = 0x00 */                        
                            Request.byte(4) = DID_NO_f;                                          /* DID Number Byte 2 = 0x00 */ 
                            Request.byte(5) =  test_suit;                                        /* Test Suite Number  - B0 */
                            Request.byte(6) =  test_case;                                        /* Test Case Number - B1 */
                            Request.byte(7) =  actual_value;                                     /* Test value needed for the test - Min, Mid, Max - B2 */
                                                
                                            
                            output(Request);                                 
                                                
                        }
                        break;
    
            case(11) :                                                                               
    
                    if(flag == 1)                                                        
                        {  
                            flag = 0;
                                                
                            Fas_Sts_VehStsSpdLo_Qfr_Na_var = ((3/1.0)-0.0); 

                            ASMC_100HZ_STATY_ST_REQ_FAA_var.Fas_Sts_VehStsSpdLo_Qfr_Na =  Fas_Sts_VehStsSpdLo_Qfr_Na_var;  
                            
                            output(ASMC_100HZ_STATY_ST_REQ_FAA_var);                                      
                                            
                                                
                            test_suit    = 0;
                            test_case    = 11;
                            actual_value = ((3/1.0)-0.0);
                            
                            write("test suit = %d, test case = %d,",test_suit,test_case); 
                                            
                            Request.dlc = 8;                                                     /* CAN Frame DLC */
                            Request.byte(0) = 0x10;                                              /* FF frame */
                            Request.byte(1) = size_dlc;                                          /* Total length of request message -> DID length + SID + DID  = 0B */ 
                            Request.byte(2) = SID_NO;                                            /* SID = 2E */  
                            Request.byte(3) = DID_NO_h;                                          /* DID Number Byte 1 = 0x00 */                        
                            Request.byte(4) = DID_NO_f;                                          /* DID Number Byte 2 = 0x00 */ 
                            Request.byte(5) =  test_suit;                                        /* Test Suite Number  - B0 */
                            Request.byte(6) =  test_case;                                        /* Test Case Number - B1 */
                            Request.byte(7) =  actual_value;                                     /* Test value needed for the test - Min, Mid, Max - B2 */
                                                
                                            
                            output(Request);                                 
                                                
                        }
                        break;
    
            case(12) :                                                                               
    
                    if(flag == 1)                                                        
                        {  
                            flag = 0;
                                                
                            Fas_Sts_VehSpdLo_Na_var = ((0/1.0)-0.0); 

                            ASMC_100HZ_STATY_ST_REQ_FAA_var.Fas_Sts_VehSpdLo_Na =  Fas_Sts_VehSpdLo_Na_var;  
                            
                            output(ASMC_100HZ_STATY_ST_REQ_FAA_var);                                      
                                            
                                                
                            test_suit    = 0;
                            test_case    = 12;
                            actual_value = ((0/1.0)-0.0);
                            
                            write("test suit = %d, test case = %d,",test_suit,test_case); 
                                            
                            Request.dlc = 8;                                                     /* CAN Frame DLC */
                            Request.byte(0) = 0x10;                                              /* FF frame */
                            Request.byte(1) = size_dlc;                                          /* Total length of request message -> DID length + SID + DID  = 0B */ 
                            Request.byte(2) = SID_NO;                                            /* SID = 2E */  
                            Request.byte(3) = DID_NO_h;                                          /* DID Number Byte 1 = 0x00 */                        
                            Request.byte(4) = DID_NO_f;                                          /* DID Number Byte 2 = 0x00 */ 
                            Request.byte(5) =  test_suit;                                        /* Test Suite Number  - B0 */
                            Request.byte(6) =  test_case;                                        /* Test Case Number - B1 */
                            Request.byte(7) =  actual_value;                                     /* Test value needed for the test - Min, Mid, Max - B2 */
                                                
                                            
                            output(Request);                                 
                                                
                        }
                        break;
    
            case(13) :                                                                               
    
                    if(flag == 1)                                                        
                        {  
                            flag = 0;
                                                
                            Fas_Sts_VehSpdLo_Na_var = ((1/1.0)-0.0); 

                            ASMC_100HZ_STATY_ST_REQ_FAA_var.Fas_Sts_VehSpdLo_Na =  Fas_Sts_VehSpdLo_Na_var;  
                            
                            output(ASMC_100HZ_STATY_ST_REQ_FAA_var);                                      
                                            
                                                
                            test_suit    = 0;
                            test_case    = 13;
                            actual_value = ((1/1.0)-0.0);
                            
                            write("test suit = %d, test case = %d,",test_suit,test_case); 
                                            
                            Request.dlc = 8;                                                     /* CAN Frame DLC */
                            Request.byte(0) = 0x10;                                              /* FF frame */
                            Request.byte(1) = size_dlc;                                          /* Total length of request message -> DID length + SID + DID  = 0B */ 
                            Request.byte(2) = SID_NO;                                            /* SID = 2E */  
                            Request.byte(3) = DID_NO_h;                                          /* DID Number Byte 1 = 0x00 */                        
                            Request.byte(4) = DID_NO_f;                                          /* DID Number Byte 2 = 0x00 */ 
                            Request.byte(5) =  test_suit;                                        /* Test Suite Number  - B0 */
                            Request.byte(6) =  test_case;                                        /* Test Case Number - B1 */
                            Request.byte(7) =  actual_value;                                     /* Test value needed for the test - Min, Mid, Max - B2 */
                                                
                                            
                            output(Request);                                 
                                                
                        }
                        break;
    
            case(14) :                                                                               
    
                    if(flag == 1)                                                        
                        {  
                            flag = 0;
                                                
                            Fas_Sts_VehSpdLo_Na_var = ((2/1.0)-0.0); 

                            ASMC_100HZ_STATY_ST_REQ_FAA_var.Fas_Sts_VehSpdLo_Na =  Fas_Sts_VehSpdLo_Na_var;  
                            
                            output(ASMC_100HZ_STATY_ST_REQ_FAA_var);                                      
                                            
                                                
                            test_suit    = 0;
                            test_case    = 14;
                            actual_value = ((2/1.0)-0.0);
                            
                            write("test suit = %d, test case = %d,",test_suit,test_case); 
                                            
                            Request.dlc = 8;                                                     /* CAN Frame DLC */
                            Request.byte(0) = 0x10;                                              /* FF frame */
                            Request.byte(1) = size_dlc;                                          /* Total length of request message -> DID length + SID + DID  = 0B */ 
                            Request.byte(2) = SID_NO;                                            /* SID = 2E */  
                            Request.byte(3) = DID_NO_h;                                          /* DID Number Byte 1 = 0x00 */                        
                            Request.byte(4) = DID_NO_f;                                          /* DID Number Byte 2 = 0x00 */ 
                            Request.byte(5) =  test_suit;                                        /* Test Suite Number  - B0 */
                            Request.byte(6) =  test_case;                                        /* Test Case Number - B1 */
                            Request.byte(7) =  actual_value;                                     /* Test value needed for the test - Min, Mid, Max - B2 */
                                                
                                            
                            output(Request);                                 
                                                
                        }
                        break;
    
            case(15) :                                                                               
    
                    if(flag == 1)                                                        
                        {  
                            flag = 0;
                                                
                            Fas_Sts_VehStsStaty_Qfr_Na_var = ((0/1.0)-0.0); 

                            ASMC_100HZ_STATY_ST_REQ_FAA_var.Fas_Sts_VehStsStaty_Qfr_Na =  Fas_Sts_VehStsStaty_Qfr_Na_var;  
                            
                            output(ASMC_100HZ_STATY_ST_REQ_FAA_var);                                      
                                            
                                                
                            test_suit    = 0;
                            test_case    = 15;
                            actual_value = ((0/1.0)-0.0);
                            
                            write("test suit = %d, test case = %d,",test_suit,test_case); 
                                            
                            Request.dlc = 8;                                                     /* CAN Frame DLC */
                            Request.byte(0) = 0x10;                                              /* FF frame */
                            Request.byte(1) = size_dlc;                                          /* Total length of request message -> DID length + SID + DID  = 0B */ 
                            Request.byte(2) = SID_NO;                                            /* SID = 2E */  
                            Request.byte(3) = DID_NO_h;                                          /* DID Number Byte 1 = 0x00 */                        
                            Request.byte(4) = DID_NO_f;                                          /* DID Number Byte 2 = 0x00 */ 
                            Request.byte(5) =  test_suit;                                        /* Test Suite Number  - B0 */
                            Request.byte(6) =  test_case;                                        /* Test Case Number - B1 */
                            Request.byte(7) =  actual_value;                                     /* Test value needed for the test - Min, Mid, Max - B2 */
                                                
                                            
                            output(Request);                                 
                                                
                        }
                        break;
    
            case(16) :                                                                               
    
                    if(flag == 1)                                                        
                        {  
                            flag = 0;
                                                
                            Fas_Sts_VehStsStaty_Qfr_Na_var = ((1/1.0)-0.0); 

                            ASMC_100HZ_STATY_ST_REQ_FAA_var.Fas_Sts_VehStsStaty_Qfr_Na =  Fas_Sts_VehStsStaty_Qfr_Na_var;  
                            
                            output(ASMC_100HZ_STATY_ST_REQ_FAA_var);                                      
                                            
                                                
                            test_suit    = 0;
                            test_case    = 16;
                            actual_value = ((1/1.0)-0.0);
                            
                            write("test suit = %d, test case = %d,",test_suit,test_case); 
                                            
                            Request.dlc = 8;                                                     /* CAN Frame DLC */
                            Request.byte(0) = 0x10;                                              /* FF frame */
                            Request.byte(1) = size_dlc;                                          /* Total length of request message -> DID length + SID + DID  = 0B */ 
                            Request.byte(2) = SID_NO;                                            /* SID = 2E */  
                            Request.byte(3) = DID_NO_h;                                          /* DID Number Byte 1 = 0x00 */                        
                            Request.byte(4) = DID_NO_f;                                          /* DID Number Byte 2 = 0x00 */ 
                            Request.byte(5) =  test_suit;                                        /* Test Suite Number  - B0 */
                            Request.byte(6) =  test_case;                                        /* Test Case Number - B1 */
                            Request.byte(7) =  actual_value;                                     /* Test value needed for the test - Min, Mid, Max - B2 */
                                                
                                            
                            output(Request);                                 
                                                
                        }
                        break;
    
            case(17) :                                                                               
    
                    if(flag == 1)                                                        
                        {  
                            flag = 0;
                                                
                            Fas_Sts_VehStsStaty_Qfr_Na_var = ((3/1.0)-0.0); 

                            ASMC_100HZ_STATY_ST_REQ_FAA_var.Fas_Sts_VehStsStaty_Qfr_Na =  Fas_Sts_VehStsStaty_Qfr_Na_var;  
                            
                            output(ASMC_100HZ_STATY_ST_REQ_FAA_var);                                      
                                            
                                                
                            test_suit    = 0;
                            test_case    = 17;
                            actual_value = ((3/1.0)-0.0);
                            
                            write("test suit = %d, test case = %d,",test_suit,test_case); 
                                            
                            Request.dlc = 8;                                                     /* CAN Frame DLC */
                            Request.byte(0) = 0x10;                                              /* FF frame */
                            Request.byte(1) = size_dlc;                                          /* Total length of request message -> DID length + SID + DID  = 0B */ 
                            Request.byte(2) = SID_NO;                                            /* SID = 2E */  
                            Request.byte(3) = DID_NO_h;                                          /* DID Number Byte 1 = 0x00 */                        
                            Request.byte(4) = DID_NO_f;                                          /* DID Number Byte 2 = 0x00 */ 
                            Request.byte(5) =  test_suit;                                        /* Test Suite Number  - B0 */
                            Request.byte(6) =  test_case;                                        /* Test Case Number - B1 */
                            Request.byte(7) =  actual_value;                                     /* Test value needed for the test - Min, Mid, Max - B2 */
                                                
                                            
                            output(Request);                                 
                                                
                        }
                        break;
    
            case(18) :                                                                               
    
                    if(flag == 1)                                                        
                        {  
                            flag = 0;
                                                
                            Fas_Sts_VehStaty_Na_var = ((0/1.0)-0.0); 

                            ASMC_100HZ_STATY_ST_REQ_FAA_var.Fas_Sts_VehStaty_Na =  Fas_Sts_VehStaty_Na_var;  
                            
                            output(ASMC_100HZ_STATY_ST_REQ_FAA_var);                                      
                                            
                                                
                            test_suit    = 0;
                            test_case    = 18;
                            actual_value = ((0/1.0)-0.0);
                            
                            write("test suit = %d, test case = %d,",test_suit,test_case); 
                                            
                            Request.dlc = 8;                                                     /* CAN Frame DLC */
                            Request.byte(0) = 0x10;                                              /* FF frame */
                            Request.byte(1) = size_dlc;                                          /* Total length of request message -> DID length + SID + DID  = 0B */ 
                            Request.byte(2) = SID_NO;                                            /* SID = 2E */  
                            Request.byte(3) = DID_NO_h;                                          /* DID Number Byte 1 = 0x00 */                        
                            Request.byte(4) = DID_NO_f;                                          /* DID Number Byte 2 = 0x00 */ 
                            Request.byte(5) =  test_suit;                                        /* Test Suite Number  - B0 */
                            Request.byte(6) =  test_case;                                        /* Test Case Number - B1 */
                            Request.byte(7) =  actual_value;                                     /* Test value needed for the test - Min, Mid, Max - B2 */
                                                
                                            
                            output(Request);                                 
                                                
                        }
                        break;
    
            case(19) :                                                                               
    
                    if(flag == 1)                                                        
                        {  
                            flag = 0;
                                                
                            Fas_Sts_VehStaty_Na_var = ((1/1.0)-0.0); 

                            ASMC_100HZ_STATY_ST_REQ_FAA_var.Fas_Sts_VehStaty_Na =  Fas_Sts_VehStaty_Na_var;  
                            
                            output(ASMC_100HZ_STATY_ST_REQ_FAA_var);                                      
                                            
                                                
                            test_suit    = 0;
                            test_case    = 19;
                            actual_value = ((1/1.0)-0.0);
                            
                            write("test suit = %d, test case = %d,",test_suit,test_case); 
                                            
                            Request.dlc = 8;                                                     /* CAN Frame DLC */
                            Request.byte(0) = 0x10;                                              /* FF frame */
                            Request.byte(1) = size_dlc;                                          /* Total length of request message -> DID length + SID + DID  = 0B */ 
                            Request.byte(2) = SID_NO;                                            /* SID = 2E */  
                            Request.byte(3) = DID_NO_h;                                          /* DID Number Byte 1 = 0x00 */                        
                            Request.byte(4) = DID_NO_f;                                          /* DID Number Byte 2 = 0x00 */ 
                            Request.byte(5) =  test_suit;                                        /* Test Suite Number  - B0 */
                            Request.byte(6) =  test_case;                                        /* Test Case Number - B1 */
                            Request.byte(7) =  actual_value;                                     /* Test value needed for the test - Min, Mid, Max - B2 */
                                                
                                            
                            output(Request);                                 
                                                
                        }
                        break;
    
            case(20) :                                                                               
    
                    if(flag == 1)                                                        
                        {  
                            flag = 0;
                                                
                            Fas_Sts_VehStaty_Na_var = ((2/1.0)-0.0); 

                            ASMC_100HZ_STATY_ST_REQ_FAA_var.Fas_Sts_VehStaty_Na =  Fas_Sts_VehStaty_Na_var;  
                            
                            output(ASMC_100HZ_STATY_ST_REQ_FAA_var);                                      
                                            
                                                
                            test_suit    = 0;
                            test_case    = 20;
                            actual_value = ((2/1.0)-0.0);
                            
                            write("test suit = %d, test case = %d,",test_suit,test_case); 
                                            
                            Request.dlc = 8;                                                     /* CAN Frame DLC */
                            Request.byte(0) = 0x10;                                              /* FF frame */
                            Request.byte(1) = size_dlc;                                          /* Total length of request message -> DID length + SID + DID  = 0B */ 
                            Request.byte(2) = SID_NO;                                            /* SID = 2E */  
                            Request.byte(3) = DID_NO_h;                                          /* DID Number Byte 1 = 0x00 */                        
                            Request.byte(4) = DID_NO_f;                                          /* DID Number Byte 2 = 0x00 */ 
                            Request.byte(5) =  test_suit;                                        /* Test Suite Number  - B0 */
                            Request.byte(6) =  test_case;                                        /* Test Case Number - B1 */
                            Request.byte(7) =  actual_value;                                     /* Test value needed for the test - Min, Mid, Max - B2 */
                                                
                                            
                            output(Request);                                 
                                                
                        }
                        break;
    
            case(21) :                                                                               
    
                    if(flag == 1)                                                        
                        {  
                            flag = 0;
                                                
                            Asmc_100Hz_Sts_VehStaty_Crc_var = ((0/1.0)-0.0); 

                            ASMC_100HZ_STATY_ST_REQ_FAA_var.Asmc_100Hz_Sts_VehStaty_Crc =  Asmc_100Hz_Sts_VehStaty_Crc_var;  
                            
                            output(ASMC_100HZ_STATY_ST_REQ_FAA_var);                                      
                                            
                                                
                            test_suit    = 0;
                            test_case    = 21;
                            actual_value = ((0/1.0)-0.0);
                            
                            write("test suit = %d, test case = %d,",test_suit,test_case); 
                                            
                            Request.dlc = 8;                                                     /* CAN Frame DLC */
                            Request.byte(0) = 0x10;                                              /* FF frame */
                            Request.byte(1) = size_dlc;                                          /* Total length of request message -> DID length + SID + DID  = 0B */ 
                            Request.byte(2) = SID_NO;                                            /* SID = 2E */  
                            Request.byte(3) = DID_NO_h;                                          /* DID Number Byte 1 = 0x00 */                        
                            Request.byte(4) = DID_NO_f;                                          /* DID Number Byte 2 = 0x00 */ 
                            Request.byte(5) =  test_suit;                                        /* Test Suite Number  - B0 */
                            Request.byte(6) =  test_case;                                        /* Test Case Number - B1 */
                            Request.byte(7) =  actual_value;                                     /* Test value needed for the test - Min, Mid, Max - B2 */
                                                
                                            
                            output(Request);                                 
                                                
                        }
                        break;
    
            case(22) :                                                                               
    
                    if(flag == 1)                                                        
                        {  
                            flag = 0;
                                                
                            Asmc_100Hz_Sts_VehStaty_Crc_var = ((127/1.0)-0.0); 

                            ASMC_100HZ_STATY_ST_REQ_FAA_var.Asmc_100Hz_Sts_VehStaty_Crc =  Asmc_100Hz_Sts_VehStaty_Crc_var;  
                            
                            output(ASMC_100HZ_STATY_ST_REQ_FAA_var);                                      
                                            
                                                
                            test_suit    = 0;
                            test_case    = 22;
                            actual_value = ((127/1.0)-0.0);
                            
                            write("test suit = %d, test case = %d,",test_suit,test_case); 
                                            
                            Request.dlc = 8;                                                     /* CAN Frame DLC */
                            Request.byte(0) = 0x10;                                              /* FF frame */
                            Request.byte(1) = size_dlc;                                          /* Total length of request message -> DID length + SID + DID  = 0B */ 
                            Request.byte(2) = SID_NO;                                            /* SID = 2E */  
                            Request.byte(3) = DID_NO_h;                                          /* DID Number Byte 1 = 0x00 */                        
                            Request.byte(4) = DID_NO_f;                                          /* DID Number Byte 2 = 0x00 */ 
                            Request.byte(5) =  test_suit;                                        /* Test Suite Number  - B0 */
                            Request.byte(6) =  test_case;                                        /* Test Case Number - B1 */
                            Request.byte(7) =  actual_value;                                     /* Test value needed for the test - Min, Mid, Max - B2 */
                                                
                                            
                            output(Request);                                 
                                                
                        }
                        break;
    
            case(23) :                                                                               
    
                    if(flag == 1)                                                        
                        {  
                            flag = 0;
                                                
                            Asmc_100Hz_Sts_VehStaty_Crc_var = ((255/1.0)-0.0); 

                            ASMC_100HZ_STATY_ST_REQ_FAA_var.Asmc_100Hz_Sts_VehStaty_Crc =  Asmc_100Hz_Sts_VehStaty_Crc_var;  
                            
                            output(ASMC_100HZ_STATY_ST_REQ_FAA_var);                                      
                                            
                                                
                            test_suit    = 0;
                            test_case    = 23;
                            actual_value = ((255/1.0)-0.0);
                            
                            write("test suit = %d, test case = %d,",test_suit,test_case); 
                                            
                            Request.dlc = 8;                                                     /* CAN Frame DLC */
                            Request.byte(0) = 0x10;                                              /* FF frame */
                            Request.byte(1) = size_dlc;                                          /* Total length of request message -> DID length + SID + DID  = 0B */ 
                            Request.byte(2) = SID_NO;                                            /* SID = 2E */  
                            Request.byte(3) = DID_NO_h;                                          /* DID Number Byte 1 = 0x00 */                        
                            Request.byte(4) = DID_NO_f;                                          /* DID Number Byte 2 = 0x00 */ 
                            Request.byte(5) =  test_suit;                                        /* Test Suite Number  - B0 */
                            Request.byte(6) =  test_case;                                        /* Test Case Number - B1 */
                            Request.byte(7) =  actual_value;                                     /* Test value needed for the test - Min, Mid, Max - B2 */
                                                
                                            
                            output(Request);                                 
                                                
                        }
                        break;
    
            case(24) :                                                                               
    
                    if(flag == 1)                                                        
                        {  
                            flag = 0;
                                                
                            Asmc_100Hz_Sts_VehStaty_AlvCtr_var = ((0/1.0)-0.0); 

                            ASMC_100HZ_STATY_ST_REQ_FAA_var.Asmc_100Hz_Sts_VehStaty_AlvCtr =  Asmc_100Hz_Sts_VehStaty_AlvCtr_var;  
                            
                            output(ASMC_100HZ_STATY_ST_REQ_FAA_var);                                      
                                            
                                                
                            test_suit    = 0;
                            test_case    = 24;
                            actual_value = ((0/1.0)-0.0);
                            
                            write("test suit = %d, test case = %d,",test_suit,test_case); 
                                            
                            Request.dlc = 8;                                                     /* CAN Frame DLC */
                            Request.byte(0) = 0x10;                                              /* FF frame */
                            Request.byte(1) = size_dlc;                                          /* Total length of request message -> DID length + SID + DID  = 0B */ 
                            Request.byte(2) = SID_NO;                                            /* SID = 2E */  
                            Request.byte(3) = DID_NO_h;                                          /* DID Number Byte 1 = 0x00 */                        
                            Request.byte(4) = DID_NO_f;                                          /* DID Number Byte 2 = 0x00 */ 
                            Request.byte(5) =  test_suit;                                        /* Test Suite Number  - B0 */
                            Request.byte(6) =  test_case;                                        /* Test Case Number - B1 */
                            Request.byte(7) =  actual_value;                                     /* Test value needed for the test - Min, Mid, Max - B2 */
                                                
                                            
                            output(Request);                                 
                                                
                        }
                        break;
    
            case(25) :                                                                               
    
                    if(flag == 1)                                                        
                        {  
                            flag = 0;
                                                
                            Asmc_100Hz_Sts_VehStaty_AlvCtr_var = ((7/1.0)-0.0); 

                            ASMC_100HZ_STATY_ST_REQ_FAA_var.Asmc_100Hz_Sts_VehStaty_AlvCtr =  Asmc_100Hz_Sts_VehStaty_AlvCtr_var;  
                            
                            output(ASMC_100HZ_STATY_ST_REQ_FAA_var);                                      
                                            
                                                
                            test_suit    = 0;
                            test_case    = 25;
                            actual_value = ((7/1.0)-0.0);
                            
                            write("test suit = %d, test case = %d,",test_suit,test_case); 
                                            
                            Request.dlc = 8;                                                     /* CAN Frame DLC */
                            Request.byte(0) = 0x10;                                              /* FF frame */
                            Request.byte(1) = size_dlc;                                          /* Total length of request message -> DID length + SID + DID  = 0B */ 
                            Request.byte(2) = SID_NO;                                            /* SID = 2E */  
                            Request.byte(3) = DID_NO_h;                                          /* DID Number Byte 1 = 0x00 */                        
                            Request.byte(4) = DID_NO_f;                                          /* DID Number Byte 2 = 0x00 */ 
                            Request.byte(5) =  test_suit;                                        /* Test Suite Number  - B0 */
                            Request.byte(6) =  test_case;                                        /* Test Case Number - B1 */
                            Request.byte(7) =  actual_value;                                     /* Test value needed for the test - Min, Mid, Max - B2 */
                                                
                                            
                            output(Request);                                 
                                                
                        }
                        break;
    
            case(26) :                                                                               
    
                    if(flag == 1)                                                        
                        {  
                            flag = 0;
                                                
                            Asmc_100Hz_Sts_VehStaty_AlvCtr_var = ((14/1.0)-0.0); 

                            ASMC_100HZ_STATY_ST_REQ_FAA_var.Asmc_100Hz_Sts_VehStaty_AlvCtr =  Asmc_100Hz_Sts_VehStaty_AlvCtr_var;  
                            
                            output(ASMC_100HZ_STATY_ST_REQ_FAA_var);                                      
                                            
                                                
                            test_suit    = 0;
                            test_case    = 26;
                            actual_value = ((14/1.0)-0.0);
                            
                            write("test suit = %d, test case = %d,",test_suit,test_case); 
                                            
                            Request.dlc = 8;                                                     /* CAN Frame DLC */
                            Request.byte(0) = 0x10;                                              /* FF frame */
                            Request.byte(1) = size_dlc;                                          /* Total length of request message -> DID length + SID + DID  = 0B */ 
                            Request.byte(2) = SID_NO;                                            /* SID = 2E */  
                            Request.byte(3) = DID_NO_h;                                          /* DID Number Byte 1 = 0x00 */                        
                            Request.byte(4) = DID_NO_f;                                          /* DID Number Byte 2 = 0x00 */ 
                            Request.byte(5) =  test_suit;                                        /* Test Suite Number  - B0 */
                            Request.byte(6) =  test_case;                                        /* Test Case Number - B1 */
                            Request.byte(7) =  actual_value;                                     /* Test value needed for the test - Min, Mid, Max - B2 */
                                                
                                            
                            output(Request);                                 
                                                
                        }
                        break;
    
            case(27) :                                                                               
    
                    if(flag == 1)                                                        
                        {  
                            flag = 0;
                                                
                            Faa_Sts_F_Qfr_Na_var = ((0/1.0)-0.0); 

                            ASMC_1000HZ_F_CMD_FAA_var.Faa_Sts_F_Qfr_Na =  Faa_Sts_F_Qfr_Na_var;  
                            
                            output(ASMC_1000HZ_F_CMD_FAA_var);                                      
                                            
                                                
                            test_suit    = 0;
                            test_case    = 27;
                            actual_value = ((0/1.0)-0.0);
                            
                            write("test suit = %d, test case = %d,",test_suit,test_case); 
                                            
                            Request.dlc = 8;                                                     /* CAN Frame DLC */
                            Request.byte(0) = 0x10;                                              /* FF frame */
                            Request.byte(1) = size_dlc;                                          /* Total length of request message -> DID length + SID + DID  = 0B */ 
                            Request.byte(2) = SID_NO;                                            /* SID = 2E */  
                            Request.byte(3) = DID_NO_h;                                          /* DID Number Byte 1 = 0x00 */                        
                            Request.byte(4) = DID_NO_f;                                          /* DID Number Byte 2 = 0x00 */ 
                            Request.byte(5) =  test_suit;                                        /* Test Suite Number  - B0 */
                            Request.byte(6) =  test_case;                                        /* Test Case Number - B1 */
                            Request.byte(7) =  actual_value;                                     /* Test value needed for the test - Min, Mid, Max - B2 */
                                                
                                            
                            output(Request);                                 
                                                
                        }
                        break;
    
            case(28) :                                                                               
    
                    if(flag == 1)                                                        
                        {  
                            flag = 0;
                                                
                            Faa_Sts_F_Qfr_Na_var = ((1/1.0)-0.0); 

                            ASMC_1000HZ_F_CMD_FAA_var.Faa_Sts_F_Qfr_Na =  Faa_Sts_F_Qfr_Na_var;  
                            
                            output(ASMC_1000HZ_F_CMD_FAA_var);                                      
                                            
                                                
                            test_suit    = 0;
                            test_case    = 28;
                            actual_value = ((1/1.0)-0.0);
                            
                            write("test suit = %d, test case = %d,",test_suit,test_case); 
                                            
                            Request.dlc = 8;                                                     /* CAN Frame DLC */
                            Request.byte(0) = 0x10;                                              /* FF frame */
                            Request.byte(1) = size_dlc;                                          /* Total length of request message -> DID length + SID + DID  = 0B */ 
                            Request.byte(2) = SID_NO;                                            /* SID = 2E */  
                            Request.byte(3) = DID_NO_h;                                          /* DID Number Byte 1 = 0x00 */                        
                            Request.byte(4) = DID_NO_f;                                          /* DID Number Byte 2 = 0x00 */ 
                            Request.byte(5) =  test_suit;                                        /* Test Suite Number  - B0 */
                            Request.byte(6) =  test_case;                                        /* Test Case Number - B1 */
                            Request.byte(7) =  actual_value;                                     /* Test value needed for the test - Min, Mid, Max - B2 */
                                                
                                            
                            output(Request);                                 
                                                
                        }
                        break;
    
            case(29) :                                                                               
    
                    if(flag == 1)                                                        
                        {  
                            flag = 0;
                                                
                            Faa_Sts_F_Qfr_Na_var = ((3/1.0)-0.0); 

                            ASMC_1000HZ_F_CMD_FAA_var.Faa_Sts_F_Qfr_Na =  Faa_Sts_F_Qfr_Na_var;  
                            
                            output(ASMC_1000HZ_F_CMD_FAA_var);                                      
                                            
                                                
                            test_suit    = 0;
                            test_case    = 29;
                            actual_value = ((3/1.0)-0.0);
                            
                            write("test suit = %d, test case = %d,",test_suit,test_case); 
                                            
                            Request.dlc = 8;                                                     /* CAN Frame DLC */
                            Request.byte(0) = 0x10;                                              /* FF frame */
                            Request.byte(1) = size_dlc;                                          /* Total length of request message -> DID length + SID + DID  = 0B */ 
                            Request.byte(2) = SID_NO;                                            /* SID = 2E */  
                            Request.byte(3) = DID_NO_h;                                          /* DID Number Byte 1 = 0x00 */                        
                            Request.byte(4) = DID_NO_f;                                          /* DID Number Byte 2 = 0x00 */ 
                            Request.byte(5) =  test_suit;                                        /* Test Suite Number  - B0 */
                            Request.byte(6) =  test_case;                                        /* Test Case Number - B1 */
                            Request.byte(7) =  actual_value;                                     /* Test value needed for the test - Min, Mid, Max - B2 */
                                                
                                            
                            output(Request);                                 
                                                
                        }
                        break;
    
            case(30) :                                                                               
    
                    if(flag == 1)                                                        
                        {  
                            flag = 0;
                                                
                            Faa_F_Rr_AtActr_Cmd_Nwt_var = ((-8000/4.0)-0.0); 

                            ASMC_1000HZ_F_CMD_FAA_var.Faa_F_Rr_AtActr_Cmd_Nwt =  Faa_F_Rr_AtActr_Cmd_Nwt_var;  
                            
                            output(ASMC_1000HZ_F_CMD_FAA_var);                                      
                                            
                                                
                            test_suit    = 0;
                            test_case    = 30;
                            actual_value = ((-8000/4.0)-0.0);
                            
                            write("test suit = %d, test case = %d,",test_suit,test_case); 
                                            
                            Request.dlc = 8;                                                     /* CAN Frame DLC */
                            Request.byte(0) = 0x10;                                              /* FF frame */
                            Request.byte(1) = size_dlc;                                          /* Total length of request message -> DID length + SID + DID  = 0B */ 
                            Request.byte(2) = SID_NO;                                            /* SID = 2E */  
                            Request.byte(3) = DID_NO_h;                                          /* DID Number Byte 1 = 0x00 */                        
                            Request.byte(4) = DID_NO_f;                                          /* DID Number Byte 2 = 0x00 */ 
                            Request.byte(5) =  test_suit;                                        /* Test Suite Number  - B0 */
                            Request.byte(6) =  test_case;                                        /* Test Case Number - B1 */
                            Request.byte(7) =  actual_value;                                     /* Test value needed for the test - Min, Mid, Max - B2 */
                                                
                                            
                            output(Request);                                 
                                                
                        }
                        break;
    
            case(31) :                                                                               
    
                    if(flag == 1)                                                        
                        {  
                            flag = 0;
                                                
                            Faa_F_Rr_AtActr_Cmd_Nwt_var = ((0/4.0)-0.0); 

                            ASMC_1000HZ_F_CMD_FAA_var.Faa_F_Rr_AtActr_Cmd_Nwt =  Faa_F_Rr_AtActr_Cmd_Nwt_var;  
                            
                            output(ASMC_1000HZ_F_CMD_FAA_var);                                      
                                            
                                                
                            test_suit    = 0;
                            test_case    = 31;
                            actual_value = ((0/4.0)-0.0);
                            
                            write("test suit = %d, test case = %d,",test_suit,test_case); 
                                            
                            Request.dlc = 8;                                                     /* CAN Frame DLC */
                            Request.byte(0) = 0x10;                                              /* FF frame */
                            Request.byte(1) = size_dlc;                                          /* Total length of request message -> DID length + SID + DID  = 0B */ 
                            Request.byte(2) = SID_NO;                                            /* SID = 2E */  
                            Request.byte(3) = DID_NO_h;                                          /* DID Number Byte 1 = 0x00 */                        
                            Request.byte(4) = DID_NO_f;                                          /* DID Number Byte 2 = 0x00 */ 
                            Request.byte(5) =  test_suit;                                        /* Test Suite Number  - B0 */
                            Request.byte(6) =  test_case;                                        /* Test Case Number - B1 */
                            Request.byte(7) =  actual_value;                                     /* Test value needed for the test - Min, Mid, Max - B2 */
                                                
                                            
                            output(Request);                                 
                                                
                        }
                        break;
    
            case(32) :                                                                               
    
                    if(flag == 1)                                                        
                        {  
                            flag = 0;
                                                
                            Faa_F_Rr_AtActr_Cmd_Nwt_var = ((8000/4.0)-0.0); 

                            ASMC_1000HZ_F_CMD_FAA_var.Faa_F_Rr_AtActr_Cmd_Nwt =  Faa_F_Rr_AtActr_Cmd_Nwt_var;  
                            
                            output(ASMC_1000HZ_F_CMD_FAA_var);                                      
                                            
                                                
                            test_suit    = 0;
                            test_case    = 32;
                            actual_value = ((8000/4.0)-0.0);
                            
                            write("test suit = %d, test case = %d,",test_suit,test_case); 
                                            
                            Request.dlc = 8;                                                     /* CAN Frame DLC */
                            Request.byte(0) = 0x10;                                              /* FF frame */
                            Request.byte(1) = size_dlc;                                          /* Total length of request message -> DID length + SID + DID  = 0B */ 
                            Request.byte(2) = SID_NO;                                            /* SID = 2E */  
                            Request.byte(3) = DID_NO_h;                                          /* DID Number Byte 1 = 0x00 */                        
                            Request.byte(4) = DID_NO_f;                                          /* DID Number Byte 2 = 0x00 */ 
                            Request.byte(5) =  test_suit;                                        /* Test Suite Number  - B0 */
                            Request.byte(6) =  test_case;                                        /* Test Case Number - B1 */
                            Request.byte(7) =  actual_value;                                     /* Test value needed for the test - Min, Mid, Max - B2 */
                                                
                                            
                            output(Request);                                 
                                                
                        }
                        break;
    
            case(33) :                                                                               
    
                    if(flag == 1)                                                        
                        {  
                            flag = 0;
                                                
                            Faa_F_Rl_AtActr_Cmd_Nwt_var = ((-8000/4.0)-0.0); 

                            ASMC_1000HZ_F_CMD_FAA_var.Faa_F_Rl_AtActr_Cmd_Nwt =  Faa_F_Rl_AtActr_Cmd_Nwt_var;  
                            
                            output(ASMC_1000HZ_F_CMD_FAA_var);                                      
                                            
                                                
                            test_suit    = 0;
                            test_case    = 33;
                            actual_value = ((-8000/4.0)-0.0);
                            
                            write("test suit = %d, test case = %d,",test_suit,test_case); 
                                            
                            Request.dlc = 8;                                                     /* CAN Frame DLC */
                            Request.byte(0) = 0x10;                                              /* FF frame */
                            Request.byte(1) = size_dlc;                                          /* Total length of request message -> DID length + SID + DID  = 0B */ 
                            Request.byte(2) = SID_NO;                                            /* SID = 2E */  
                            Request.byte(3) = DID_NO_h;                                          /* DID Number Byte 1 = 0x00 */                        
                            Request.byte(4) = DID_NO_f;                                          /* DID Number Byte 2 = 0x00 */ 
                            Request.byte(5) =  test_suit;                                        /* Test Suite Number  - B0 */
                            Request.byte(6) =  test_case;                                        /* Test Case Number - B1 */
                            Request.byte(7) =  actual_value;                                     /* Test value needed for the test - Min, Mid, Max - B2 */
                                                
                                            
                            output(Request);                                 
                                                
                        }
                        break;
    
            case(34) :                                                                               
    
                    if(flag == 1)                                                        
                        {  
                            flag = 0;
                                                
                            Faa_F_Rl_AtActr_Cmd_Nwt_var = ((0/4.0)-0.0); 

                            ASMC_1000HZ_F_CMD_FAA_var.Faa_F_Rl_AtActr_Cmd_Nwt =  Faa_F_Rl_AtActr_Cmd_Nwt_var;  
                            
                            output(ASMC_1000HZ_F_CMD_FAA_var);                                      
                                            
                                                
                            test_suit    = 0;
                            test_case    = 34;
                            actual_value = ((0/4.0)-0.0);
                            
                            write("test suit = %d, test case = %d,",test_suit,test_case); 
                                            
                            Request.dlc = 8;                                                     /* CAN Frame DLC */
                            Request.byte(0) = 0x10;                                              /* FF frame */
                            Request.byte(1) = size_dlc;                                          /* Total length of request message -> DID length + SID + DID  = 0B */ 
                            Request.byte(2) = SID_NO;                                            /* SID = 2E */  
                            Request.byte(3) = DID_NO_h;                                          /* DID Number Byte 1 = 0x00 */                        
                            Request.byte(4) = DID_NO_f;                                          /* DID Number Byte 2 = 0x00 */ 
                            Request.byte(5) =  test_suit;                                        /* Test Suite Number  - B0 */
                            Request.byte(6) =  test_case;                                        /* Test Case Number - B1 */
                            Request.byte(7) =  actual_value;                                     /* Test value needed for the test - Min, Mid, Max - B2 */
                                                
                                            
                            output(Request);                                 
                                                
                        }
                        break;
    
            case(35) :                                                                               
    
                    if(flag == 1)                                                        
                        {  
                            flag = 0;
                                                
                            Faa_F_Rl_AtActr_Cmd_Nwt_var = ((8000/4.0)-0.0); 

                            ASMC_1000HZ_F_CMD_FAA_var.Faa_F_Rl_AtActr_Cmd_Nwt =  Faa_F_Rl_AtActr_Cmd_Nwt_var;  
                            
                            output(ASMC_1000HZ_F_CMD_FAA_var);                                      
                                            
                                                
                            test_suit    = 0;
                            test_case    = 35;
                            actual_value = ((8000/4.0)-0.0);
                            
                            write("test suit = %d, test case = %d,",test_suit,test_case); 
                                            
                            Request.dlc = 8;                                                     /* CAN Frame DLC */
                            Request.byte(0) = 0x10;                                              /* FF frame */
                            Request.byte(1) = size_dlc;                                          /* Total length of request message -> DID length + SID + DID  = 0B */ 
                            Request.byte(2) = SID_NO;                                            /* SID = 2E */  
                            Request.byte(3) = DID_NO_h;                                          /* DID Number Byte 1 = 0x00 */                        
                            Request.byte(4) = DID_NO_f;                                          /* DID Number Byte 2 = 0x00 */ 
                            Request.byte(5) =  test_suit;                                        /* Test Suite Number  - B0 */
                            Request.byte(6) =  test_case;                                        /* Test Case Number - B1 */
                            Request.byte(7) =  actual_value;                                     /* Test value needed for the test - Min, Mid, Max - B2 */
                                                
                                            
                            output(Request);                                 
                                                
                        }
                        break;
    
            case(36) :                                                                               
    
                    if(flag == 1)                                                        
                        {  
                            flag = 0;
                                                
                            Faa_F_Fr_AtActr_Cmd_Nwt_var = ((-8000/4.0)-0.0); 

                            ASMC_1000HZ_F_CMD_FAA_var.Faa_F_Fr_AtActr_Cmd_Nwt =  Faa_F_Fr_AtActr_Cmd_Nwt_var;  
                            
                            output(ASMC_1000HZ_F_CMD_FAA_var);                                      
                                            
                                                
                            test_suit    = 0;
                            test_case    = 36;
                            actual_value = ((-8000/4.0)-0.0);
                            
                            write("test suit = %d, test case = %d,",test_suit,test_case); 
                                            
                            Request.dlc = 8;                                                     /* CAN Frame DLC */
                            Request.byte(0) = 0x10;                                              /* FF frame */
                            Request.byte(1) = size_dlc;                                          /* Total length of request message -> DID length + SID + DID  = 0B */ 
                            Request.byte(2) = SID_NO;                                            /* SID = 2E */  
                            Request.byte(3) = DID_NO_h;                                          /* DID Number Byte 1 = 0x00 */                        
                            Request.byte(4) = DID_NO_f;                                          /* DID Number Byte 2 = 0x00 */ 
                            Request.byte(5) =  test_suit;                                        /* Test Suite Number  - B0 */
                            Request.byte(6) =  test_case;                                        /* Test Case Number - B1 */
                            Request.byte(7) =  actual_value;                                     /* Test value needed for the test - Min, Mid, Max - B2 */
                                                
                                            
                            output(Request);                                 
                                                
                        }
                        break;
    
            case(37) :                                                                               
    
                    if(flag == 1)                                                        
                        {  
                            flag = 0;
                                                
                            Faa_F_Fr_AtActr_Cmd_Nwt_var = ((0/4.0)-0.0); 

                            ASMC_1000HZ_F_CMD_FAA_var.Faa_F_Fr_AtActr_Cmd_Nwt =  Faa_F_Fr_AtActr_Cmd_Nwt_var;  
                            
                            output(ASMC_1000HZ_F_CMD_FAA_var);                                      
                                            
                                                
                            test_suit    = 0;
                            test_case    = 37;
                            actual_value = ((0/4.0)-0.0);
                            
                            write("test suit = %d, test case = %d,",test_suit,test_case); 
                                            
                            Request.dlc = 8;                                                     /* CAN Frame DLC */
                            Request.byte(0) = 0x10;                                              /* FF frame */
                            Request.byte(1) = size_dlc;                                          /* Total length of request message -> DID length + SID + DID  = 0B */ 
                            Request.byte(2) = SID_NO;                                            /* SID = 2E */  
                            Request.byte(3) = DID_NO_h;                                          /* DID Number Byte 1 = 0x00 */                        
                            Request.byte(4) = DID_NO_f;                                          /* DID Number Byte 2 = 0x00 */ 
                            Request.byte(5) =  test_suit;                                        /* Test Suite Number  - B0 */
                            Request.byte(6) =  test_case;                                        /* Test Case Number - B1 */
                            Request.byte(7) =  actual_value;                                     /* Test value needed for the test - Min, Mid, Max - B2 */
                                                
                                            
                            output(Request);                                 
                                                
                        }
                        break;
    
            case(38) :                                                                               
    
                    if(flag == 1)                                                        
                        {  
                            flag = 0;
                                                
                            Faa_F_Fr_AtActr_Cmd_Nwt_var = ((8000/4.0)-0.0); 

                            ASMC_1000HZ_F_CMD_FAA_var.Faa_F_Fr_AtActr_Cmd_Nwt =  Faa_F_Fr_AtActr_Cmd_Nwt_var;  
                            
                            output(ASMC_1000HZ_F_CMD_FAA_var);                                      
                                            
                                                
                            test_suit    = 0;
                            test_case    = 38;
                            actual_value = ((8000/4.0)-0.0);
                            
                            write("test suit = %d, test case = %d,",test_suit,test_case); 
                                            
                            Request.dlc = 8;                                                     /* CAN Frame DLC */
                            Request.byte(0) = 0x10;                                              /* FF frame */
                            Request.byte(1) = size_dlc;                                          /* Total length of request message -> DID length + SID + DID  = 0B */ 
                            Request.byte(2) = SID_NO;                                            /* SID = 2E */  
                            Request.byte(3) = DID_NO_h;                                          /* DID Number Byte 1 = 0x00 */                        
                            Request.byte(4) = DID_NO_f;                                          /* DID Number Byte 2 = 0x00 */ 
                            Request.byte(5) =  test_suit;                                        /* Test Suite Number  - B0 */
                            Request.byte(6) =  test_case;                                        /* Test Case Number - B1 */
                            Request.byte(7) =  actual_value;                                     /* Test value needed for the test - Min, Mid, Max - B2 */
                                                
                                            
                            output(Request);                                 
                                                
                        }
                        break;
    
            case(39) :                                                                               
    
                    if(flag == 1)                                                        
                        {  
                            flag = 0;
                                                
                            Faa_F_Fl_AtActr_Cmd_Nwt_var = ((-8000/4.0)-0.0); 

                            ASMC_1000HZ_F_CMD_FAA_var.Faa_F_Fl_AtActr_Cmd_Nwt =  Faa_F_Fl_AtActr_Cmd_Nwt_var;  
                            
                            output(ASMC_1000HZ_F_CMD_FAA_var);                                      
                                            
                                                
                            test_suit    = 0;
                            test_case    = 39;
                            actual_value = ((-8000/4.0)-0.0);
                            
                            write("test suit = %d, test case = %d,",test_suit,test_case); 
                                            
                            Request.dlc = 8;                                                     /* CAN Frame DLC */
                            Request.byte(0) = 0x10;                                              /* FF frame */
                            Request.byte(1) = size_dlc;                                          /* Total length of request message -> DID length + SID + DID  = 0B */ 
                            Request.byte(2) = SID_NO;                                            /* SID = 2E */  
                            Request.byte(3) = DID_NO_h;                                          /* DID Number Byte 1 = 0x00 */                        
                            Request.byte(4) = DID_NO_f;                                          /* DID Number Byte 2 = 0x00 */ 
                            Request.byte(5) =  test_suit;                                        /* Test Suite Number  - B0 */
                            Request.byte(6) =  test_case;                                        /* Test Case Number - B1 */
                            Request.byte(7) =  actual_value;                                     /* Test value needed for the test - Min, Mid, Max - B2 */
                                                
                                            
                            output(Request);                                 
                                                
                        }
                        break;
    
            case(40) :                                                                               
    
                    if(flag == 1)                                                        
                        {  
                            flag = 0;
                                                
                            Faa_F_Fl_AtActr_Cmd_Nwt_var = ((0/4.0)-0.0); 

                            ASMC_1000HZ_F_CMD_FAA_var.Faa_F_Fl_AtActr_Cmd_Nwt =  Faa_F_Fl_AtActr_Cmd_Nwt_var;  
                            
                            output(ASMC_1000HZ_F_CMD_FAA_var);                                      
                                            
                                                
                            test_suit    = 0;
                            test_case    = 40;
                            actual_value = ((0/4.0)-0.0);
                            
                            write("test suit = %d, test case = %d,",test_suit,test_case); 
                                            
                            Request.dlc = 8;                                                     /* CAN Frame DLC */
                            Request.byte(0) = 0x10;                                              /* FF frame */
                            Request.byte(1) = size_dlc;                                          /* Total length of request message -> DID length + SID + DID  = 0B */ 
                            Request.byte(2) = SID_NO;                                            /* SID = 2E */  
                            Request.byte(3) = DID_NO_h;                                          /* DID Number Byte 1 = 0x00 */                        
                            Request.byte(4) = DID_NO_f;                                          /* DID Number Byte 2 = 0x00 */ 
                            Request.byte(5) =  test_suit;                                        /* Test Suite Number  - B0 */
                            Request.byte(6) =  test_case;                                        /* Test Case Number - B1 */
                            Request.byte(7) =  actual_value;                                     /* Test value needed for the test - Min, Mid, Max - B2 */
                                                
                                            
                            output(Request);                                 
                                                
                        }
                        break;
    
            case(41) :                                                                               
    
                    if(flag == 1)                                                        
                        {  
                            flag = 0;
                                                
                            Faa_F_Fl_AtActr_Cmd_Nwt_var = ((8000/4.0)-0.0); 

                            ASMC_1000HZ_F_CMD_FAA_var.Faa_F_Fl_AtActr_Cmd_Nwt =  Faa_F_Fl_AtActr_Cmd_Nwt_var;  
                            
                            output(ASMC_1000HZ_F_CMD_FAA_var);                                      
                                            
                                                
                            test_suit    = 0;
                            test_case    = 41;
                            actual_value = ((8000/4.0)-0.0);
                            
                            write("test suit = %d, test case = %d,",test_suit,test_case); 
                                            
                            Request.dlc = 8;                                                     /* CAN Frame DLC */
                            Request.byte(0) = 0x10;                                              /* FF frame */
                            Request.byte(1) = size_dlc;                                          /* Total length of request message -> DID length + SID + DID  = 0B */ 
                            Request.byte(2) = SID_NO;                                            /* SID = 2E */  
                            Request.byte(3) = DID_NO_h;                                          /* DID Number Byte 1 = 0x00 */                        
                            Request.byte(4) = DID_NO_f;                                          /* DID Number Byte 2 = 0x00 */ 
                            Request.byte(5) =  test_suit;                                        /* Test Suite Number  - B0 */
                            Request.byte(6) =  test_case;                                        /* Test Case Number - B1 */
                            Request.byte(7) =  actual_value;                                     /* Test value needed for the test - Min, Mid, Max - B2 */
                                                
                                            
                            output(Request);                                 
                                                
                        }
                        break;
    
            case(42) :                                                                               
    
                    if(flag == 1)                                                        
                        {  
                            flag = 0;
                                                
                            Asmc_1000Hz_F_Cmd_Crc_var = ((0/1.0)-0.0); 

                            ASMC_1000HZ_F_CMD_FAA_var.Asmc_1000Hz_F_Cmd_Crc =  Asmc_1000Hz_F_Cmd_Crc_var;  
                            
                            output(ASMC_1000HZ_F_CMD_FAA_var);                                      
                                            
                                                
                            test_suit    = 0;
                            test_case    = 42;
                            actual_value = ((0/1.0)-0.0);
                            
                            write("test suit = %d, test case = %d,",test_suit,test_case); 
                                            
                            Request.dlc = 8;                                                     /* CAN Frame DLC */
                            Request.byte(0) = 0x10;                                              /* FF frame */
                            Request.byte(1) = size_dlc;                                          /* Total length of request message -> DID length + SID + DID  = 0B */ 
                            Request.byte(2) = SID_NO;                                            /* SID = 2E */  
                            Request.byte(3) = DID_NO_h;                                          /* DID Number Byte 1 = 0x00 */                        
                            Request.byte(4) = DID_NO_f;                                          /* DID Number Byte 2 = 0x00 */ 
                            Request.byte(5) =  test_suit;                                        /* Test Suite Number  - B0 */
                            Request.byte(6) =  test_case;                                        /* Test Case Number - B1 */
                            Request.byte(7) =  actual_value;                                     /* Test value needed for the test - Min, Mid, Max - B2 */
                                                
                                            
                            output(Request);                                 
                                                
                        }
                        break;
    
            case(43) :                                                                               
    
                    if(flag == 1)                                                        
                        {  
                            flag = 0;
                                                
                            Asmc_1000Hz_F_Cmd_Crc_var = ((127/1.0)-0.0); 

                            ASMC_1000HZ_F_CMD_FAA_var.Asmc_1000Hz_F_Cmd_Crc =  Asmc_1000Hz_F_Cmd_Crc_var;  
                            
                            output(ASMC_1000HZ_F_CMD_FAA_var);                                      
                                            
                                                
                            test_suit    = 0;
                            test_case    = 43;
                            actual_value = ((127/1.0)-0.0);
                            
                            write("test suit = %d, test case = %d,",test_suit,test_case); 
                                            
                            Request.dlc = 8;                                                     /* CAN Frame DLC */
                            Request.byte(0) = 0x10;                                              /* FF frame */
                            Request.byte(1) = size_dlc;                                          /* Total length of request message -> DID length + SID + DID  = 0B */ 
                            Request.byte(2) = SID_NO;                                            /* SID = 2E */  
                            Request.byte(3) = DID_NO_h;                                          /* DID Number Byte 1 = 0x00 */                        
                            Request.byte(4) = DID_NO_f;                                          /* DID Number Byte 2 = 0x00 */ 
                            Request.byte(5) =  test_suit;                                        /* Test Suite Number  - B0 */
                            Request.byte(6) =  test_case;                                        /* Test Case Number - B1 */
                            Request.byte(7) =  actual_value;                                     /* Test value needed for the test - Min, Mid, Max - B2 */
                                                
                                            
                            output(Request);                                 
                                                
                        }
                        break;
    
            case(44) :                                                                               
    
                    if(flag == 1)                                                        
                        {  
                            flag = 0;
                                                
                            Asmc_1000Hz_F_Cmd_Crc_var = ((255/1.0)-0.0); 

                            ASMC_1000HZ_F_CMD_FAA_var.Asmc_1000Hz_F_Cmd_Crc =  Asmc_1000Hz_F_Cmd_Crc_var;  
                            
                            output(ASMC_1000HZ_F_CMD_FAA_var);                                      
                                            
                                                
                            test_suit    = 0;
                            test_case    = 44;
                            actual_value = ((255/1.0)-0.0);
                            
                            write("test suit = %d, test case = %d,",test_suit,test_case); 
                                            
                            Request.dlc = 8;                                                     /* CAN Frame DLC */
                            Request.byte(0) = 0x10;                                              /* FF frame */
                            Request.byte(1) = size_dlc;                                          /* Total length of request message -> DID length + SID + DID  = 0B */ 
                            Request.byte(2) = SID_NO;                                            /* SID = 2E */  
                            Request.byte(3) = DID_NO_h;                                          /* DID Number Byte 1 = 0x00 */                        
                            Request.byte(4) = DID_NO_f;                                          /* DID Number Byte 2 = 0x00 */ 
                            Request.byte(5) =  test_suit;                                        /* Test Suite Number  - B0 */
                            Request.byte(6) =  test_case;                                        /* Test Case Number - B1 */
                            Request.byte(7) =  actual_value;                                     /* Test value needed for the test - Min, Mid, Max - B2 */
                                                
                                            
                            output(Request);                                 
                                                
                        }
                        break;
    
            case(45) :                                                                               
    
                    if(flag == 1)                                                        
                        {  
                            flag = 0;
                                                
                            Asmc_1000Hz_F_Cmd_AlvCtr_var = ((0/1.0)-0.0); 

                            ASMC_1000HZ_F_CMD_FAA_var.Asmc_1000Hz_F_Cmd_AlvCtr =  Asmc_1000Hz_F_Cmd_AlvCtr_var;  
                            
                            output(ASMC_1000HZ_F_CMD_FAA_var);                                      
                                            
                                                
                            test_suit    = 0;
                            test_case    = 45;
                            actual_value = ((0/1.0)-0.0);
                            
                            write("test suit = %d, test case = %d,",test_suit,test_case); 
                                            
                            Request.dlc = 8;                                                     /* CAN Frame DLC */
                            Request.byte(0) = 0x10;                                              /* FF frame */
                            Request.byte(1) = size_dlc;                                          /* Total length of request message -> DID length + SID + DID  = 0B */ 
                            Request.byte(2) = SID_NO;                                            /* SID = 2E */  
                            Request.byte(3) = DID_NO_h;                                          /* DID Number Byte 1 = 0x00 */                        
                            Request.byte(4) = DID_NO_f;                                          /* DID Number Byte 2 = 0x00 */ 
                            Request.byte(5) =  test_suit;                                        /* Test Suite Number  - B0 */
                            Request.byte(6) =  test_case;                                        /* Test Case Number - B1 */
                            Request.byte(7) =  actual_value;                                     /* Test value needed for the test - Min, Mid, Max - B2 */
                                                
                                            
                            output(Request);                                 
                                                
                        }
                        break;
    
            case(46) :                                                                               
    
                    if(flag == 1)                                                        
                        {  
                            flag = 0;
                                                
                            Asmc_1000Hz_F_Cmd_AlvCtr_var = ((7/1.0)-0.0); 

                            ASMC_1000HZ_F_CMD_FAA_var.Asmc_1000Hz_F_Cmd_AlvCtr =  Asmc_1000Hz_F_Cmd_AlvCtr_var;  
                            
                            output(ASMC_1000HZ_F_CMD_FAA_var);                                      
                                            
                                                
                            test_suit    = 0;
                            test_case    = 46;
                            actual_value = ((7/1.0)-0.0);
                            
                            write("test suit = %d, test case = %d,",test_suit,test_case); 
                                            
                            Request.dlc = 8;                                                     /* CAN Frame DLC */
                            Request.byte(0) = 0x10;                                              /* FF frame */
                            Request.byte(1) = size_dlc;                                          /* Total length of request message -> DID length + SID + DID  = 0B */ 
                            Request.byte(2) = SID_NO;                                            /* SID = 2E */  
                            Request.byte(3) = DID_NO_h;                                          /* DID Number Byte 1 = 0x00 */                        
                            Request.byte(4) = DID_NO_f;                                          /* DID Number Byte 2 = 0x00 */ 
                            Request.byte(5) =  test_suit;                                        /* Test Suite Number  - B0 */
                            Request.byte(6) =  test_case;                                        /* Test Case Number - B1 */
                            Request.byte(7) =  actual_value;                                     /* Test value needed for the test - Min, Mid, Max - B2 */
                                                
                                            
                            output(Request);                                 
                                                
                        }
                        break;
    
            case(47) :                                                                               
    
                    if(flag == 1)                                                        
                        {  
                            flag = 0;
                                                
                            Asmc_1000Hz_F_Cmd_AlvCtr_var = ((14/1.0)-0.0); 

                            ASMC_1000HZ_F_CMD_FAA_var.Asmc_1000Hz_F_Cmd_AlvCtr =  Asmc_1000Hz_F_Cmd_AlvCtr_var;  
                            
                            output(ASMC_1000HZ_F_CMD_FAA_var);                                      
                                            
                                                
                            test_suit    = 0;
                            test_case    = 47;
                            actual_value = ((14/1.0)-0.0);
                            
                            write("test suit = %d, test case = %d,",test_suit,test_case); 
                                            
                            Request.dlc = 8;                                                     /* CAN Frame DLC */
                            Request.byte(0) = 0x10;                                              /* FF frame */
                            Request.byte(1) = size_dlc;                                          /* Total length of request message -> DID length + SID + DID  = 0B */ 
                            Request.byte(2) = SID_NO;                                            /* SID = 2E */  
                            Request.byte(3) = DID_NO_h;                                          /* DID Number Byte 1 = 0x00 */                        
                            Request.byte(4) = DID_NO_f;                                          /* DID Number Byte 2 = 0x00 */ 
                            Request.byte(5) =  test_suit;                                        /* Test Suite Number  - B0 */
                            Request.byte(6) =  test_case;                                        /* Test Case Number - B1 */
                            Request.byte(7) =  actual_value;                                     /* Test value needed for the test - Min, Mid, Max - B2 */
                                                
                                            
                            output(Request);                                 
                                                
                        }
                        break;
    
            case(48) :                                                                               
    
                    if(flag == 1)                                                        
                        {  
                            flag = 0;
                                                
                            Faa_Sts_ZlMofr_Re_Qfr_Na_var = ((0/1.0)-0.0); 

                            ASMC_100HZ_ZL_MOFR_FAA_var.Faa_Sts_ZlMofr_Re_Qfr_Na =  Faa_Sts_ZlMofr_Re_Qfr_Na_var;  
                            
                            output(ASMC_100HZ_ZL_MOFR_FAA_var);                                      
                                            
                                                
                            test_suit    = 0;
                            test_case    = 48;
                            actual_value = ((0/1.0)-0.0);
                            
                            write("test suit = %d, test case = %d,",test_suit,test_case); 
                                            
                            Request.dlc = 8;                                                     /* CAN Frame DLC */
                            Request.byte(0) = 0x10;                                              /* FF frame */
                            Request.byte(1) = size_dlc;                                          /* Total length of request message -> DID length + SID + DID  = 0B */ 
                            Request.byte(2) = SID_NO;                                            /* SID = 2E */  
                            Request.byte(3) = DID_NO_h;                                          /* DID Number Byte 1 = 0x00 */                        
                            Request.byte(4) = DID_NO_f;                                          /* DID Number Byte 2 = 0x00 */ 
                            Request.byte(5) =  test_suit;                                        /* Test Suite Number  - B0 */
                            Request.byte(6) =  test_case;                                        /* Test Case Number - B1 */
                            Request.byte(7) =  actual_value;                                     /* Test value needed for the test - Min, Mid, Max - B2 */
                                                
                                            
                            output(Request);                                 
                                                
                        }
                        break;
    
            case(49) :                                                                               
    
                    if(flag == 1)                                                        
                        {  
                            flag = 0;
                                                
                            Faa_Sts_ZlMofr_Re_Qfr_Na_var = ((1/1.0)-0.0); 

                            ASMC_100HZ_ZL_MOFR_FAA_var.Faa_Sts_ZlMofr_Re_Qfr_Na =  Faa_Sts_ZlMofr_Re_Qfr_Na_var;  
                            
                            output(ASMC_100HZ_ZL_MOFR_FAA_var);                                      
                                            
                                                
                            test_suit    = 0;
                            test_case    = 49;
                            actual_value = ((1/1.0)-0.0);
                            
                            write("test suit = %d, test case = %d,",test_suit,test_case); 
                                            
                            Request.dlc = 8;                                                     /* CAN Frame DLC */
                            Request.byte(0) = 0x10;                                              /* FF frame */
                            Request.byte(1) = size_dlc;                                          /* Total length of request message -> DID length + SID + DID  = 0B */ 
                            Request.byte(2) = SID_NO;                                            /* SID = 2E */  
                            Request.byte(3) = DID_NO_h;                                          /* DID Number Byte 1 = 0x00 */                        
                            Request.byte(4) = DID_NO_f;                                          /* DID Number Byte 2 = 0x00 */ 
                            Request.byte(5) =  test_suit;                                        /* Test Suite Number  - B0 */
                            Request.byte(6) =  test_case;                                        /* Test Case Number - B1 */
                            Request.byte(7) =  actual_value;                                     /* Test value needed for the test - Min, Mid, Max - B2 */
                                                
                                            
                            output(Request);                                 
                                                
                        }
                        break;
    
            case(50) :                                                                               
    
                    if(flag == 1)                                                        
                        {  
                            flag = 0;
                                                
                            Faa_Sts_ZlMofr_Re_Qfr_Na_var = ((3/1.0)-0.0); 

                            ASMC_100HZ_ZL_MOFR_FAA_var.Faa_Sts_ZlMofr_Re_Qfr_Na =  Faa_Sts_ZlMofr_Re_Qfr_Na_var;  
                            
                            output(ASMC_100HZ_ZL_MOFR_FAA_var);                                      
                                            
                                                
                            test_suit    = 0;
                            test_case    = 50;
                            actual_value = ((3/1.0)-0.0);
                            
                            write("test suit = %d, test case = %d,",test_suit,test_case); 
                                            
                            Request.dlc = 8;                                                     /* CAN Frame DLC */
                            Request.byte(0) = 0x10;                                              /* FF frame */
                            Request.byte(1) = size_dlc;                                          /* Total length of request message -> DID length + SID + DID  = 0B */ 
                            Request.byte(2) = SID_NO;                                            /* SID = 2E */  
                            Request.byte(3) = DID_NO_h;                                          /* DID Number Byte 1 = 0x00 */                        
                            Request.byte(4) = DID_NO_f;                                          /* DID Number Byte 2 = 0x00 */ 
                            Request.byte(5) =  test_suit;                                        /* Test Suite Number  - B0 */
                            Request.byte(6) =  test_case;                                        /* Test Case Number - B1 */
                            Request.byte(7) =  actual_value;                                     /* Test value needed for the test - Min, Mid, Max - B2 */
                                                
                                            
                            output(Request);                                 
                                                
                        }
                        break;
    
            case(51) :                                                                               
    
                    if(flag == 1)                                                        
                        {  
                            flag = 0;
                                                
                            Faa_Gain_Re_ZlFil_Na_var = ((1/0.125)-1.0); 

                            ASMC_100HZ_ZL_MOFR_FAA_var.Faa_Gain_Re_ZlFil_Na =  Faa_Gain_Re_ZlFil_Na_var;  
                            
                            output(ASMC_100HZ_ZL_MOFR_FAA_var);                                      
                                            
                                                
                            test_suit    = 0;
                            test_case    = 51;
                            actual_value = ((1/0.125)-1.0);
                            
                            write("test suit = %d, test case = %d,",test_suit,test_case); 
                                            
                            Request.dlc = 8;                                                     /* CAN Frame DLC */
                            Request.byte(0) = 0x10;                                              /* FF frame */
                            Request.byte(1) = size_dlc;                                          /* Total length of request message -> DID length + SID + DID  = 0B */ 
                            Request.byte(2) = SID_NO;                                            /* SID = 2E */  
                            Request.byte(3) = DID_NO_h;                                          /* DID Number Byte 1 = 0x00 */                        
                            Request.byte(4) = DID_NO_f;                                          /* DID Number Byte 2 = 0x00 */ 
                            Request.byte(5) =  test_suit;                                        /* Test Suite Number  - B0 */
                            Request.byte(6) =  test_case;                                        /* Test Case Number - B1 */
                            Request.byte(7) =  actual_value;                                     /* Test value needed for the test - Min, Mid, Max - B2 */
                                                
                                            
                            output(Request);                                 
                                                
                        }
                        break;
    
            case(52) :                                                                               
    
                    if(flag == 1)                                                        
                        {  
                            flag = 0;
                                                
                            Faa_Gain_Re_ZlFil_Na_var = ((5/0.125)-1.0); 

                            ASMC_100HZ_ZL_MOFR_FAA_var.Faa_Gain_Re_ZlFil_Na =  Faa_Gain_Re_ZlFil_Na_var;  
                            
                            output(ASMC_100HZ_ZL_MOFR_FAA_var);                                      
                                            
                                                
                            test_suit    = 0;
                            test_case    = 52;
                            actual_value = ((5/0.125)-1.0);
                            
                            write("test suit = %d, test case = %d,",test_suit,test_case); 
                                            
                            Request.dlc = 8;                                                     /* CAN Frame DLC */
                            Request.byte(0) = 0x10;                                              /* FF frame */
                            Request.byte(1) = size_dlc;                                          /* Total length of request message -> DID length + SID + DID  = 0B */ 
                            Request.byte(2) = SID_NO;                                            /* SID = 2E */  
                            Request.byte(3) = DID_NO_h;                                          /* DID Number Byte 1 = 0x00 */                        
                            Request.byte(4) = DID_NO_f;                                          /* DID Number Byte 2 = 0x00 */ 
                            Request.byte(5) =  test_suit;                                        /* Test Suite Number  - B0 */
                            Request.byte(6) =  test_case;                                        /* Test Case Number - B1 */
                            Request.byte(7) =  actual_value;                                     /* Test value needed for the test - Min, Mid, Max - B2 */
                                                
                                            
                            output(Request);                                 
                                                
                        }
                        break;
    
            case(53) :                                                                               
    
                    if(flag == 1)                                                        
                        {  
                            flag = 0;
                                                
                            Faa_Gain_Re_ZlFil_Na_var = ((10/0.125)-1.0); 

                            ASMC_100HZ_ZL_MOFR_FAA_var.Faa_Gain_Re_ZlFil_Na =  Faa_Gain_Re_ZlFil_Na_var;  
                            
                            output(ASMC_100HZ_ZL_MOFR_FAA_var);                                      
                                            
                                                
                            test_suit    = 0;
                            test_case    = 53;
                            actual_value = ((10/0.125)-1.0);
                            
                            write("test suit = %d, test case = %d,",test_suit,test_case); 
                                            
                            Request.dlc = 8;                                                     /* CAN Frame DLC */
                            Request.byte(0) = 0x10;                                              /* FF frame */
                            Request.byte(1) = size_dlc;                                          /* Total length of request message -> DID length + SID + DID  = 0B */ 
                            Request.byte(2) = SID_NO;                                            /* SID = 2E */  
                            Request.byte(3) = DID_NO_h;                                          /* DID Number Byte 1 = 0x00 */                        
                            Request.byte(4) = DID_NO_f;                                          /* DID Number Byte 2 = 0x00 */ 
                            Request.byte(5) =  test_suit;                                        /* Test Suite Number  - B0 */
                            Request.byte(6) =  test_case;                                        /* Test Case Number - B1 */
                            Request.byte(7) =  actual_value;                                     /* Test value needed for the test - Min, Mid, Max - B2 */
                                                
                                            
                            output(Request);                                 
                                                
                        }
                        break;
    
            case(54) :                                                                               
    
                    if(flag == 1)                                                        
                        {  
                            flag = 0;
                                                
                            Faa_Wi_Re_ZlFil_Na_var = ((0/0.015625)-0.0); 

                            ASMC_100HZ_ZL_MOFR_FAA_var.Faa_Wi_Re_ZlFil_Na =  Faa_Wi_Re_ZlFil_Na_var;  
                            
                            output(ASMC_100HZ_ZL_MOFR_FAA_var);                                      
                                            
                                                
                            test_suit    = 0;
                            test_case    = 54;
                            actual_value = ((0/0.015625)-0.0);
                            
                            write("test suit = %d, test case = %d,",test_suit,test_case); 
                                            
                            Request.dlc = 8;                                                     /* CAN Frame DLC */
                            Request.byte(0) = 0x10;                                              /* FF frame */
                            Request.byte(1) = size_dlc;                                          /* Total length of request message -> DID length + SID + DID  = 0B */ 
                            Request.byte(2) = SID_NO;                                            /* SID = 2E */  
                            Request.byte(3) = DID_NO_h;                                          /* DID Number Byte 1 = 0x00 */                        
                            Request.byte(4) = DID_NO_f;                                          /* DID Number Byte 2 = 0x00 */ 
                            Request.byte(5) =  test_suit;                                        /* Test Suite Number  - B0 */
                            Request.byte(6) =  test_case;                                        /* Test Case Number - B1 */
                            Request.byte(7) =  actual_value;                                     /* Test value needed for the test - Min, Mid, Max - B2 */
                                                
                                            
                            output(Request);                                 
                                                
                        }
                        break;
    
            case(55) :                                                                               
    
                    if(flag == 1)                                                        
                        {  
                            flag = 0;
                                                
                            Faa_Wi_Re_ZlFil_Na_var = ((0/0.015625)-0.0); 

                            ASMC_100HZ_ZL_MOFR_FAA_var.Faa_Wi_Re_ZlFil_Na =  Faa_Wi_Re_ZlFil_Na_var;  
                            
                            output(ASMC_100HZ_ZL_MOFR_FAA_var);                                      
                                            
                                                
                            test_suit    = 0;
                            test_case    = 55;
                            actual_value = ((0/0.015625)-0.0);
                            
                            write("test suit = %d, test case = %d,",test_suit,test_case); 
                                            
                            Request.dlc = 8;                                                     /* CAN Frame DLC */
                            Request.byte(0) = 0x10;                                              /* FF frame */
                            Request.byte(1) = size_dlc;                                          /* Total length of request message -> DID length + SID + DID  = 0B */ 
                            Request.byte(2) = SID_NO;                                            /* SID = 2E */  
                            Request.byte(3) = DID_NO_h;                                          /* DID Number Byte 1 = 0x00 */                        
                            Request.byte(4) = DID_NO_f;                                          /* DID Number Byte 2 = 0x00 */ 
                            Request.byte(5) =  test_suit;                                        /* Test Suite Number  - B0 */
                            Request.byte(6) =  test_case;                                        /* Test Case Number - B1 */
                            Request.byte(7) =  actual_value;                                     /* Test value needed for the test - Min, Mid, Max - B2 */
                                                
                                            
                            output(Request);                                 
                                                
                        }
                        break;
    
            case(56) :                                                                               
    
                    if(flag == 1)                                                        
                        {  
                            flag = 0;
                                                
                            Faa_Wi_Re_ZlFil_Na_var = ((1/0.015625)-0.0); 

                            ASMC_100HZ_ZL_MOFR_FAA_var.Faa_Wi_Re_ZlFil_Na =  Faa_Wi_Re_ZlFil_Na_var;  
                            
                            output(ASMC_100HZ_ZL_MOFR_FAA_var);                                      
                                            
                                                
                            test_suit    = 0;
                            test_case    = 56;
                            actual_value = ((1/0.015625)-0.0);
                            
                            write("test suit = %d, test case = %d,",test_suit,test_case); 
                                            
                            Request.dlc = 8;                                                     /* CAN Frame DLC */
                            Request.byte(0) = 0x10;                                              /* FF frame */
                            Request.byte(1) = size_dlc;                                          /* Total length of request message -> DID length + SID + DID  = 0B */ 
                            Request.byte(2) = SID_NO;                                            /* SID = 2E */  
                            Request.byte(3) = DID_NO_h;                                          /* DID Number Byte 1 = 0x00 */                        
                            Request.byte(4) = DID_NO_f;                                          /* DID Number Byte 2 = 0x00 */ 
                            Request.byte(5) =  test_suit;                                        /* Test Suite Number  - B0 */
                            Request.byte(6) =  test_case;                                        /* Test Case Number - B1 */
                            Request.byte(7) =  actual_value;                                     /* Test value needed for the test - Min, Mid, Max - B2 */
                                                
                                            
                            output(Request);                                 
                                                
                        }
                        break;
    
            case(57) :                                                                               
    
                    if(flag == 1)                                                        
                        {  
                            flag = 0;
                                                
                            Faa_Frq_Re_ZlFil_Ce_Hz_var = ((3/0.0625)-2.5); 

                            ASMC_100HZ_ZL_MOFR_FAA_var.Faa_Frq_Re_ZlFil_Ce_Hz =  Faa_Frq_Re_ZlFil_Ce_Hz_var;  
                            
                            output(ASMC_100HZ_ZL_MOFR_FAA_var);                                      
                                            
                                                
                            test_suit    = 0;
                            test_case    = 57;
                            actual_value = ((3/0.0625)-2.5);
                            
                            write("test suit = %d, test case = %d,",test_suit,test_case); 
                                            
                            Request.dlc = 8;                                                     /* CAN Frame DLC */
                            Request.byte(0) = 0x10;                                              /* FF frame */
                            Request.byte(1) = size_dlc;                                          /* Total length of request message -> DID length + SID + DID  = 0B */ 
                            Request.byte(2) = SID_NO;                                            /* SID = 2E */  
                            Request.byte(3) = DID_NO_h;                                          /* DID Number Byte 1 = 0x00 */                        
                            Request.byte(4) = DID_NO_f;                                          /* DID Number Byte 2 = 0x00 */ 
                            Request.byte(5) =  test_suit;                                        /* Test Suite Number  - B0 */
                            Request.byte(6) =  test_case;                                        /* Test Case Number - B1 */
                            Request.byte(7) =  actual_value;                                     /* Test value needed for the test - Min, Mid, Max - B2 */
                                                
                                            
                            output(Request);                                 
                                                
                        }
                        break;
    
            case(58) :                                                                               
    
                    if(flag == 1)                                                        
                        {  
                            flag = 0;
                                                
                            Faa_Frq_Re_ZlFil_Ce_Hz_var = ((6/0.0625)-2.5); 

                            ASMC_100HZ_ZL_MOFR_FAA_var.Faa_Frq_Re_ZlFil_Ce_Hz =  Faa_Frq_Re_ZlFil_Ce_Hz_var;  
                            
                            output(ASMC_100HZ_ZL_MOFR_FAA_var);                                      
                                            
                                                
                            test_suit    = 0;
                            test_case    = 58;
                            actual_value = ((6/0.0625)-2.5);
                            
                            write("test suit = %d, test case = %d,",test_suit,test_case); 
                                            
                            Request.dlc = 8;                                                     /* CAN Frame DLC */
                            Request.byte(0) = 0x10;                                              /* FF frame */
                            Request.byte(1) = size_dlc;                                          /* Total length of request message -> DID length + SID + DID  = 0B */ 
                            Request.byte(2) = SID_NO;                                            /* SID = 2E */  
                            Request.byte(3) = DID_NO_h;                                          /* DID Number Byte 1 = 0x00 */                        
                            Request.byte(4) = DID_NO_f;                                          /* DID Number Byte 2 = 0x00 */ 
                            Request.byte(5) =  test_suit;                                        /* Test Suite Number  - B0 */
                            Request.byte(6) =  test_case;                                        /* Test Case Number - B1 */
                            Request.byte(7) =  actual_value;                                     /* Test value needed for the test - Min, Mid, Max - B2 */
                                                
                                            
                            output(Request);                                 
                                                
                        }
                        break;
    
            case(59) :                                                                               
    
                    if(flag == 1)                                                        
                        {  
                            flag = 0;
                                                
                            Faa_Frq_Re_ZlFil_Ce_Hz_var = ((10/0.0625)-2.5); 

                            ASMC_100HZ_ZL_MOFR_FAA_var.Faa_Frq_Re_ZlFil_Ce_Hz =  Faa_Frq_Re_ZlFil_Ce_Hz_var;  
                            
                            output(ASMC_100HZ_ZL_MOFR_FAA_var);                                      
                                            
                                                
                            test_suit    = 0;
                            test_case    = 59;
                            actual_value = ((10/0.0625)-2.5);
                            
                            write("test suit = %d, test case = %d,",test_suit,test_case); 
                                            
                            Request.dlc = 8;                                                     /* CAN Frame DLC */
                            Request.byte(0) = 0x10;                                              /* FF frame */
                            Request.byte(1) = size_dlc;                                          /* Total length of request message -> DID length + SID + DID  = 0B */ 
                            Request.byte(2) = SID_NO;                                            /* SID = 2E */  
                            Request.byte(3) = DID_NO_h;                                          /* DID Number Byte 1 = 0x00 */                        
                            Request.byte(4) = DID_NO_f;                                          /* DID Number Byte 2 = 0x00 */ 
                            Request.byte(5) =  test_suit;                                        /* Test Suite Number  - B0 */
                            Request.byte(6) =  test_case;                                        /* Test Case Number - B1 */
                            Request.byte(7) =  actual_value;                                     /* Test value needed for the test - Min, Mid, Max - B2 */
                                                
                                            
                            output(Request);                                 
                                                
                        }
                        break;
    
            case(60) :                                                                               
    
                    if(flag == 1)                                                        
                        {  
                            flag = 0;
                                                
                            Faa_Mofr_Re_ZlGain_Na_var = ((0/0.0625)-0.0); 

                            ASMC_100HZ_ZL_MOFR_FAA_var.Faa_Mofr_Re_ZlGain_Na =  Faa_Mofr_Re_ZlGain_Na_var;  
                            
                            output(ASMC_100HZ_ZL_MOFR_FAA_var);                                      
                                            
                                                
                            test_suit    = 0;
                            test_case    = 60;
                            actual_value = ((0/0.0625)-0.0);
                            
                            write("test suit = %d, test case = %d,",test_suit,test_case); 
                                            
                            Request.dlc = 8;                                                     /* CAN Frame DLC */
                            Request.byte(0) = 0x10;                                              /* FF frame */
                            Request.byte(1) = size_dlc;                                          /* Total length of request message -> DID length + SID + DID  = 0B */ 
                            Request.byte(2) = SID_NO;                                            /* SID = 2E */  
                            Request.byte(3) = DID_NO_h;                                          /* DID Number Byte 1 = 0x00 */                        
                            Request.byte(4) = DID_NO_f;                                          /* DID Number Byte 2 = 0x00 */ 
                            Request.byte(5) =  test_suit;                                        /* Test Suite Number  - B0 */
                            Request.byte(6) =  test_case;                                        /* Test Case Number - B1 */
                            Request.byte(7) =  actual_value;                                     /* Test value needed for the test - Min, Mid, Max - B2 */
                                                
                                            
                            output(Request);                                 
                                                
                        }
                        break;
    
            case(61) :                                                                               
    
                    if(flag == 1)                                                        
                        {  
                            flag = 0;
                                                
                            Faa_Mofr_Re_ZlGain_Na_var = ((0/0.0625)-0.0); 

                            ASMC_100HZ_ZL_MOFR_FAA_var.Faa_Mofr_Re_ZlGain_Na =  Faa_Mofr_Re_ZlGain_Na_var;  
                            
                            output(ASMC_100HZ_ZL_MOFR_FAA_var);                                      
                                            
                                                
                            test_suit    = 0;
                            test_case    = 61;
                            actual_value = ((0/0.0625)-0.0);
                            
                            write("test suit = %d, test case = %d,",test_suit,test_case); 
                                            
                            Request.dlc = 8;                                                     /* CAN Frame DLC */
                            Request.byte(0) = 0x10;                                              /* FF frame */
                            Request.byte(1) = size_dlc;                                          /* Total length of request message -> DID length + SID + DID  = 0B */ 
                            Request.byte(2) = SID_NO;                                            /* SID = 2E */  
                            Request.byte(3) = DID_NO_h;                                          /* DID Number Byte 1 = 0x00 */                        
                            Request.byte(4) = DID_NO_f;                                          /* DID Number Byte 2 = 0x00 */ 
                            Request.byte(5) =  test_suit;                                        /* Test Suite Number  - B0 */
                            Request.byte(6) =  test_case;                                        /* Test Case Number - B1 */
                            Request.byte(7) =  actual_value;                                     /* Test value needed for the test - Min, Mid, Max - B2 */
                                                
                                            
                            output(Request);                                 
                                                
                        }
                        break;
    
            case(62) :                                                                               
    
                    if(flag == 1)                                                        
                        {  
                            flag = 0;
                                                
                            Faa_Mofr_Re_ZlGain_Na_var = ((1/0.0625)-0.0); 

                            ASMC_100HZ_ZL_MOFR_FAA_var.Faa_Mofr_Re_ZlGain_Na =  Faa_Mofr_Re_ZlGain_Na_var;  
                            
                            output(ASMC_100HZ_ZL_MOFR_FAA_var);                                      
                                            
                                                
                            test_suit    = 0;
                            test_case    = 62;
                            actual_value = ((1/0.0625)-0.0);
                            
                            write("test suit = %d, test case = %d,",test_suit,test_case); 
                                            
                            Request.dlc = 8;                                                     /* CAN Frame DLC */
                            Request.byte(0) = 0x10;                                              /* FF frame */
                            Request.byte(1) = size_dlc;                                          /* Total length of request message -> DID length + SID + DID  = 0B */ 
                            Request.byte(2) = SID_NO;                                            /* SID = 2E */  
                            Request.byte(3) = DID_NO_h;                                          /* DID Number Byte 1 = 0x00 */                        
                            Request.byte(4) = DID_NO_f;                                          /* DID Number Byte 2 = 0x00 */ 
                            Request.byte(5) =  test_suit;                                        /* Test Suite Number  - B0 */
                            Request.byte(6) =  test_case;                                        /* Test Case Number - B1 */
                            Request.byte(7) =  actual_value;                                     /* Test value needed for the test - Min, Mid, Max - B2 */
                                                
                                            
                            output(Request);                                 
                                                
                        }
                        break;
    
            case(63) :                                                                               
    
                    if(flag == 1)                                                        
                        {  
                            flag = 0;
                                                
                            Faa_Sts_ZlMofr_Fn_Qfr_Na_var = ((0/1.0)-0.0); 

                            ASMC_100HZ_ZL_MOFR_FAA_var.Faa_Sts_ZlMofr_Fn_Qfr_Na =  Faa_Sts_ZlMofr_Fn_Qfr_Na_var;  
                            
                            output(ASMC_100HZ_ZL_MOFR_FAA_var);                                      
                                            
                                                
                            test_suit    = 0;
                            test_case    = 63;
                            actual_value = ((0/1.0)-0.0);
                            
                            write("test suit = %d, test case = %d,",test_suit,test_case); 
                                            
                            Request.dlc = 8;                                                     /* CAN Frame DLC */
                            Request.byte(0) = 0x10;                                              /* FF frame */
                            Request.byte(1) = size_dlc;                                          /* Total length of request message -> DID length + SID + DID  = 0B */ 
                            Request.byte(2) = SID_NO;                                            /* SID = 2E */  
                            Request.byte(3) = DID_NO_h;                                          /* DID Number Byte 1 = 0x00 */                        
                            Request.byte(4) = DID_NO_f;                                          /* DID Number Byte 2 = 0x00 */ 
                            Request.byte(5) =  test_suit;                                        /* Test Suite Number  - B0 */
                            Request.byte(6) =  test_case;                                        /* Test Case Number - B1 */
                            Request.byte(7) =  actual_value;                                     /* Test value needed for the test - Min, Mid, Max - B2 */
                                                
                                            
                            output(Request);                                 
                                                
                        }
                        break;
    
            case(64) :                                                                               
    
                    if(flag == 1)                                                        
                        {  
                            flag = 0;
                                                
                            Faa_Sts_ZlMofr_Fn_Qfr_Na_var = ((1/1.0)-0.0); 

                            ASMC_100HZ_ZL_MOFR_FAA_var.Faa_Sts_ZlMofr_Fn_Qfr_Na =  Faa_Sts_ZlMofr_Fn_Qfr_Na_var;  
                            
                            output(ASMC_100HZ_ZL_MOFR_FAA_var);                                      
                                            
                                                
                            test_suit    = 0;
                            test_case    = 64;
                            actual_value = ((1/1.0)-0.0);
                            
                            write("test suit = %d, test case = %d,",test_suit,test_case); 
                                            
                            Request.dlc = 8;                                                     /* CAN Frame DLC */
                            Request.byte(0) = 0x10;                                              /* FF frame */
                            Request.byte(1) = size_dlc;                                          /* Total length of request message -> DID length + SID + DID  = 0B */ 
                            Request.byte(2) = SID_NO;                                            /* SID = 2E */  
                            Request.byte(3) = DID_NO_h;                                          /* DID Number Byte 1 = 0x00 */                        
                            Request.byte(4) = DID_NO_f;                                          /* DID Number Byte 2 = 0x00 */ 
                            Request.byte(5) =  test_suit;                                        /* Test Suite Number  - B0 */
                            Request.byte(6) =  test_case;                                        /* Test Case Number - B1 */
                            Request.byte(7) =  actual_value;                                     /* Test value needed for the test - Min, Mid, Max - B2 */
                                                
                                            
                            output(Request);                                 
                                                
                        }
                        break;
    
            case(65) :                                                                               
    
                    if(flag == 1)                                                        
                        {  
                            flag = 0;
                                                
                            Faa_Sts_ZlMofr_Fn_Qfr_Na_var = ((3/1.0)-0.0); 

                            ASMC_100HZ_ZL_MOFR_FAA_var.Faa_Sts_ZlMofr_Fn_Qfr_Na =  Faa_Sts_ZlMofr_Fn_Qfr_Na_var;  
                            
                            output(ASMC_100HZ_ZL_MOFR_FAA_var);                                      
                                            
                                                
                            test_suit    = 0;
                            test_case    = 65;
                            actual_value = ((3/1.0)-0.0);
                            
                            write("test suit = %d, test case = %d,",test_suit,test_case); 
                                            
                            Request.dlc = 8;                                                     /* CAN Frame DLC */
                            Request.byte(0) = 0x10;                                              /* FF frame */
                            Request.byte(1) = size_dlc;                                          /* Total length of request message -> DID length + SID + DID  = 0B */ 
                            Request.byte(2) = SID_NO;                                            /* SID = 2E */  
                            Request.byte(3) = DID_NO_h;                                          /* DID Number Byte 1 = 0x00 */                        
                            Request.byte(4) = DID_NO_f;                                          /* DID Number Byte 2 = 0x00 */ 
                            Request.byte(5) =  test_suit;                                        /* Test Suite Number  - B0 */
                            Request.byte(6) =  test_case;                                        /* Test Case Number - B1 */
                            Request.byte(7) =  actual_value;                                     /* Test value needed for the test - Min, Mid, Max - B2 */
                                                
                                            
                            output(Request);                                 
                                                
                        }
                        break;
    
            case(66) :                                                                               
    
                    if(flag == 1)                                                        
                        {  
                            flag = 0;
                                                
                            Faa_Gain_Fn_ZlFil_Na_var = ((1/0.125)-1.0); 

                            ASMC_100HZ_ZL_MOFR_FAA_var.Faa_Gain_Fn_ZlFil_Na =  Faa_Gain_Fn_ZlFil_Na_var;  
                            
                            output(ASMC_100HZ_ZL_MOFR_FAA_var);                                      
                                            
                                                
                            test_suit    = 0;
                            test_case    = 66;
                            actual_value = ((1/0.125)-1.0);
                            
                            write("test suit = %d, test case = %d,",test_suit,test_case); 
                                            
                            Request.dlc = 8;                                                     /* CAN Frame DLC */
                            Request.byte(0) = 0x10;                                              /* FF frame */
                            Request.byte(1) = size_dlc;                                          /* Total length of request message -> DID length + SID + DID  = 0B */ 
                            Request.byte(2) = SID_NO;                                            /* SID = 2E */  
                            Request.byte(3) = DID_NO_h;                                          /* DID Number Byte 1 = 0x00 */                        
                            Request.byte(4) = DID_NO_f;                                          /* DID Number Byte 2 = 0x00 */ 
                            Request.byte(5) =  test_suit;                                        /* Test Suite Number  - B0 */
                            Request.byte(6) =  test_case;                                        /* Test Case Number - B1 */
                            Request.byte(7) =  actual_value;                                     /* Test value needed for the test - Min, Mid, Max - B2 */
                                                
                                            
                            output(Request);                                 
                                                
                        }
                        break;
    
            case(67) :                                                                               
    
                    if(flag == 1)                                                        
                        {  
                            flag = 0;
                                                
                            Faa_Gain_Fn_ZlFil_Na_var = ((5/0.125)-1.0); 

                            ASMC_100HZ_ZL_MOFR_FAA_var.Faa_Gain_Fn_ZlFil_Na =  Faa_Gain_Fn_ZlFil_Na_var;  
                            
                            output(ASMC_100HZ_ZL_MOFR_FAA_var);                                      
                                            
                                                
                            test_suit    = 0;
                            test_case    = 67;
                            actual_value = ((5/0.125)-1.0);
                            
                            write("test suit = %d, test case = %d,",test_suit,test_case); 
                                            
                            Request.dlc = 8;                                                     /* CAN Frame DLC */
                            Request.byte(0) = 0x10;                                              /* FF frame */
                            Request.byte(1) = size_dlc;                                          /* Total length of request message -> DID length + SID + DID  = 0B */ 
                            Request.byte(2) = SID_NO;                                            /* SID = 2E */  
                            Request.byte(3) = DID_NO_h;                                          /* DID Number Byte 1 = 0x00 */                        
                            Request.byte(4) = DID_NO_f;                                          /* DID Number Byte 2 = 0x00 */ 
                            Request.byte(5) =  test_suit;                                        /* Test Suite Number  - B0 */
                            Request.byte(6) =  test_case;                                        /* Test Case Number - B1 */
                            Request.byte(7) =  actual_value;                                     /* Test value needed for the test - Min, Mid, Max - B2 */
                                                
                                            
                            output(Request);                                 
                                                
                        }
                        break;
    
            case(68) :                                                                               
    
                    if(flag == 1)                                                        
                        {  
                            flag = 0;
                                                
                            Faa_Gain_Fn_ZlFil_Na_var = ((10/0.125)-1.0); 

                            ASMC_100HZ_ZL_MOFR_FAA_var.Faa_Gain_Fn_ZlFil_Na =  Faa_Gain_Fn_ZlFil_Na_var;  
                            
                            output(ASMC_100HZ_ZL_MOFR_FAA_var);                                      
                                            
                                                
                            test_suit    = 0;
                            test_case    = 68;
                            actual_value = ((10/0.125)-1.0);
                            
                            write("test suit = %d, test case = %d,",test_suit,test_case); 
                                            
                            Request.dlc = 8;                                                     /* CAN Frame DLC */
                            Request.byte(0) = 0x10;                                              /* FF frame */
                            Request.byte(1) = size_dlc;                                          /* Total length of request message -> DID length + SID + DID  = 0B */ 
                            Request.byte(2) = SID_NO;                                            /* SID = 2E */  
                            Request.byte(3) = DID_NO_h;                                          /* DID Number Byte 1 = 0x00 */                        
                            Request.byte(4) = DID_NO_f;                                          /* DID Number Byte 2 = 0x00 */ 
                            Request.byte(5) =  test_suit;                                        /* Test Suite Number  - B0 */
                            Request.byte(6) =  test_case;                                        /* Test Case Number - B1 */
                            Request.byte(7) =  actual_value;                                     /* Test value needed for the test - Min, Mid, Max - B2 */
                                                
                                            
                            output(Request);                                 
                                                
                        }
                        break;
    
            case(69) :                                                                               
    
                    if(flag == 1)                                                        
                        {  
                            flag = 0;
                                                
                            Faa_Wi_Fn_ZlFil_Na_var = ((0/0.015625)-0.0); 

                            ASMC_100HZ_ZL_MOFR_FAA_var.Faa_Wi_Fn_ZlFil_Na =  Faa_Wi_Fn_ZlFil_Na_var;  
                            
                            output(ASMC_100HZ_ZL_MOFR_FAA_var);                                      
                                            
                                                
                            test_suit    = 0;
                            test_case    = 69;
                            actual_value = ((0/0.015625)-0.0);
                            
                            write("test suit = %d, test case = %d,",test_suit,test_case); 
                                            
                            Request.dlc = 8;                                                     /* CAN Frame DLC */
                            Request.byte(0) = 0x10;                                              /* FF frame */
                            Request.byte(1) = size_dlc;                                          /* Total length of request message -> DID length + SID + DID  = 0B */ 
                            Request.byte(2) = SID_NO;                                            /* SID = 2E */  
                            Request.byte(3) = DID_NO_h;                                          /* DID Number Byte 1 = 0x00 */                        
                            Request.byte(4) = DID_NO_f;                                          /* DID Number Byte 2 = 0x00 */ 
                            Request.byte(5) =  test_suit;                                        /* Test Suite Number  - B0 */
                            Request.byte(6) =  test_case;                                        /* Test Case Number - B1 */
                            Request.byte(7) =  actual_value;                                     /* Test value needed for the test - Min, Mid, Max - B2 */
                                                
                                            
                            output(Request);                                 
                                                
                        }
                        break;
    
            case(70) :                                                                               
    
                    if(flag == 1)                                                        
                        {  
                            flag = 0;
                                                
                            Faa_Wi_Fn_ZlFil_Na_var = ((0/0.015625)-0.0); 

                            ASMC_100HZ_ZL_MOFR_FAA_var.Faa_Wi_Fn_ZlFil_Na =  Faa_Wi_Fn_ZlFil_Na_var;  
                            
                            output(ASMC_100HZ_ZL_MOFR_FAA_var);                                      
                                            
                                                
                            test_suit    = 0;
                            test_case    = 70;
                            actual_value = ((0/0.015625)-0.0);
                            
                            write("test suit = %d, test case = %d,",test_suit,test_case); 
                                            
                            Request.dlc = 8;                                                     /* CAN Frame DLC */
                            Request.byte(0) = 0x10;                                              /* FF frame */
                            Request.byte(1) = size_dlc;                                          /* Total length of request message -> DID length + SID + DID  = 0B */ 
                            Request.byte(2) = SID_NO;                                            /* SID = 2E */  
                            Request.byte(3) = DID_NO_h;                                          /* DID Number Byte 1 = 0x00 */                        
                            Request.byte(4) = DID_NO_f;                                          /* DID Number Byte 2 = 0x00 */ 
                            Request.byte(5) =  test_suit;                                        /* Test Suite Number  - B0 */
                            Request.byte(6) =  test_case;                                        /* Test Case Number - B1 */
                            Request.byte(7) =  actual_value;                                     /* Test value needed for the test - Min, Mid, Max - B2 */
                                                
                                            
                            output(Request);                                 
                                                
                        }
                        break;
    
            case(71) :                                                                               
    
                    if(flag == 1)                                                        
                        {  
                            flag = 0;
                                                
                            Faa_Wi_Fn_ZlFil_Na_var = ((1/0.015625)-0.0); 

                            ASMC_100HZ_ZL_MOFR_FAA_var.Faa_Wi_Fn_ZlFil_Na =  Faa_Wi_Fn_ZlFil_Na_var;  
                            
                            output(ASMC_100HZ_ZL_MOFR_FAA_var);                                      
                                            
                                                
                            test_suit    = 0;
                            test_case    = 71;
                            actual_value = ((1/0.015625)-0.0);
                            
                            write("test suit = %d, test case = %d,",test_suit,test_case); 
                                            
                            Request.dlc = 8;                                                     /* CAN Frame DLC */
                            Request.byte(0) = 0x10;                                              /* FF frame */
                            Request.byte(1) = size_dlc;                                          /* Total length of request message -> DID length + SID + DID  = 0B */ 
                            Request.byte(2) = SID_NO;                                            /* SID = 2E */  
                            Request.byte(3) = DID_NO_h;                                          /* DID Number Byte 1 = 0x00 */                        
                            Request.byte(4) = DID_NO_f;                                          /* DID Number Byte 2 = 0x00 */ 
                            Request.byte(5) =  test_suit;                                        /* Test Suite Number  - B0 */
                            Request.byte(6) =  test_case;                                        /* Test Case Number - B1 */
                            Request.byte(7) =  actual_value;                                     /* Test value needed for the test - Min, Mid, Max - B2 */
                                                
                                            
                            output(Request);                                 
                                                
                        }
                        break;
    
            case(72) :                                                                               
    
                    if(flag == 1)                                                        
                        {  
                            flag = 0;
                                                
                            Faa_Frq_Fn_ZlFil_Ce_Hz_var = ((3/0.0625)-2.5); 

                            ASMC_100HZ_ZL_MOFR_FAA_var.Faa_Frq_Fn_ZlFil_Ce_Hz =  Faa_Frq_Fn_ZlFil_Ce_Hz_var;  
                            
                            output(ASMC_100HZ_ZL_MOFR_FAA_var);                                      
                                            
                                                
                            test_suit    = 0;
                            test_case    = 72;
                            actual_value = ((3/0.0625)-2.5);
                            
                            write("test suit = %d, test case = %d,",test_suit,test_case); 
                                            
                            Request.dlc = 8;                                                     /* CAN Frame DLC */
                            Request.byte(0) = 0x10;                                              /* FF frame */
                            Request.byte(1) = size_dlc;                                          /* Total length of request message -> DID length + SID + DID  = 0B */ 
                            Request.byte(2) = SID_NO;                                            /* SID = 2E */  
                            Request.byte(3) = DID_NO_h;                                          /* DID Number Byte 1 = 0x00 */                        
                            Request.byte(4) = DID_NO_f;                                          /* DID Number Byte 2 = 0x00 */ 
                            Request.byte(5) =  test_suit;                                        /* Test Suite Number  - B0 */
                            Request.byte(6) =  test_case;                                        /* Test Case Number - B1 */
                            Request.byte(7) =  actual_value;                                     /* Test value needed for the test - Min, Mid, Max - B2 */
                                                
                                            
                            output(Request);                                 
                                                
                        }
                        break;
    
            case(73) :                                                                               
    
                    if(flag == 1)                                                        
                        {  
                            flag = 0;
                                                
                            Faa_Frq_Fn_ZlFil_Ce_Hz_var = ((6/0.0625)-2.5); 

                            ASMC_100HZ_ZL_MOFR_FAA_var.Faa_Frq_Fn_ZlFil_Ce_Hz =  Faa_Frq_Fn_ZlFil_Ce_Hz_var;  
                            
                            output(ASMC_100HZ_ZL_MOFR_FAA_var);                                      
                                            
                                                
                            test_suit    = 0;
                            test_case    = 73;
                            actual_value = ((6/0.0625)-2.5);
                            
                            write("test suit = %d, test case = %d,",test_suit,test_case); 
                                            
                            Request.dlc = 8;                                                     /* CAN Frame DLC */
                            Request.byte(0) = 0x10;                                              /* FF frame */
                            Request.byte(1) = size_dlc;                                          /* Total length of request message -> DID length + SID + DID  = 0B */ 
                            Request.byte(2) = SID_NO;                                            /* SID = 2E */  
                            Request.byte(3) = DID_NO_h;                                          /* DID Number Byte 1 = 0x00 */                        
                            Request.byte(4) = DID_NO_f;                                          /* DID Number Byte 2 = 0x00 */ 
                            Request.byte(5) =  test_suit;                                        /* Test Suite Number  - B0 */
                            Request.byte(6) =  test_case;                                        /* Test Case Number - B1 */
                            Request.byte(7) =  actual_value;                                     /* Test value needed for the test - Min, Mid, Max - B2 */
                                                
                                            
                            output(Request);                                 
                                                
                        }
                        break;
    
            case(74) :                                                                               
    
                    if(flag == 1)                                                        
                        {  
                            flag = 0;
                                                
                            Faa_Frq_Fn_ZlFil_Ce_Hz_var = ((10/0.0625)-2.5); 

                            ASMC_100HZ_ZL_MOFR_FAA_var.Faa_Frq_Fn_ZlFil_Ce_Hz =  Faa_Frq_Fn_ZlFil_Ce_Hz_var;  
                            
                            output(ASMC_100HZ_ZL_MOFR_FAA_var);                                      
                                            
                                                
                            test_suit    = 0;
                            test_case    = 74;
                            actual_value = ((10/0.0625)-2.5);
                            
                            write("test suit = %d, test case = %d,",test_suit,test_case); 
                                            
                            Request.dlc = 8;                                                     /* CAN Frame DLC */
                            Request.byte(0) = 0x10;                                              /* FF frame */
                            Request.byte(1) = size_dlc;                                          /* Total length of request message -> DID length + SID + DID  = 0B */ 
                            Request.byte(2) = SID_NO;                                            /* SID = 2E */  
                            Request.byte(3) = DID_NO_h;                                          /* DID Number Byte 1 = 0x00 */                        
                            Request.byte(4) = DID_NO_f;                                          /* DID Number Byte 2 = 0x00 */ 
                            Request.byte(5) =  test_suit;                                        /* Test Suite Number  - B0 */
                            Request.byte(6) =  test_case;                                        /* Test Case Number - B1 */
                            Request.byte(7) =  actual_value;                                     /* Test value needed for the test - Min, Mid, Max - B2 */
                                                
                                            
                            output(Request);                                 
                                                
                        }
                        break;
    
            case(75) :                                                                               
    
                    if(flag == 1)                                                        
                        {  
                            flag = 0;
                                                
                            Faa_Mofr_Fn_ZlGain_Na_var = ((0/0.0625)-0.0); 

                            ASMC_100HZ_ZL_MOFR_FAA_var.Faa_Mofr_Fn_ZlGain_Na =  Faa_Mofr_Fn_ZlGain_Na_var;  
                            
                            output(ASMC_100HZ_ZL_MOFR_FAA_var);                                      
                                            
                                                
                            test_suit    = 0;
                            test_case    = 75;
                            actual_value = ((0/0.0625)-0.0);
                            
                            write("test suit = %d, test case = %d,",test_suit,test_case); 
                                            
                            Request.dlc = 8;                                                     /* CAN Frame DLC */
                            Request.byte(0) = 0x10;                                              /* FF frame */
                            Request.byte(1) = size_dlc;                                          /* Total length of request message -> DID length + SID + DID  = 0B */ 
                            Request.byte(2) = SID_NO;                                            /* SID = 2E */  
                            Request.byte(3) = DID_NO_h;                                          /* DID Number Byte 1 = 0x00 */                        
                            Request.byte(4) = DID_NO_f;                                          /* DID Number Byte 2 = 0x00 */ 
                            Request.byte(5) =  test_suit;                                        /* Test Suite Number  - B0 */
                            Request.byte(6) =  test_case;                                        /* Test Case Number - B1 */
                            Request.byte(7) =  actual_value;                                     /* Test value needed for the test - Min, Mid, Max - B2 */
                                                
                                            
                            output(Request);                                 
                                                
                        }
                        break;
    
            case(76) :                                                                               
    
                    if(flag == 1)                                                        
                        {  
                            flag = 0;
                                                
                            Faa_Mofr_Fn_ZlGain_Na_var = ((0/0.0625)-0.0); 

                            ASMC_100HZ_ZL_MOFR_FAA_var.Faa_Mofr_Fn_ZlGain_Na =  Faa_Mofr_Fn_ZlGain_Na_var;  
                            
                            output(ASMC_100HZ_ZL_MOFR_FAA_var);                                      
                                            
                                                
                            test_suit    = 0;
                            test_case    = 76;
                            actual_value = ((0/0.0625)-0.0);
                            
                            write("test suit = %d, test case = %d,",test_suit,test_case); 
                                            
                            Request.dlc = 8;                                                     /* CAN Frame DLC */
                            Request.byte(0) = 0x10;                                              /* FF frame */
                            Request.byte(1) = size_dlc;                                          /* Total length of request message -> DID length + SID + DID  = 0B */ 
                            Request.byte(2) = SID_NO;                                            /* SID = 2E */  
                            Request.byte(3) = DID_NO_h;                                          /* DID Number Byte 1 = 0x00 */                        
                            Request.byte(4) = DID_NO_f;                                          /* DID Number Byte 2 = 0x00 */ 
                            Request.byte(5) =  test_suit;                                        /* Test Suite Number  - B0 */
                            Request.byte(6) =  test_case;                                        /* Test Case Number - B1 */
                            Request.byte(7) =  actual_value;                                     /* Test value needed for the test - Min, Mid, Max - B2 */
                                                
                                            
                            output(Request);                                 
                                                
                        }
                        break;
    
            case(77) :                                                                               
    
                    if(flag == 1)                                                        
                        {  
                            flag = 0;
                                                
                            Faa_Mofr_Fn_ZlGain_Na_var = ((1/0.0625)-0.0); 

                            ASMC_100HZ_ZL_MOFR_FAA_var.Faa_Mofr_Fn_ZlGain_Na =  Faa_Mofr_Fn_ZlGain_Na_var;  
                            
                            output(ASMC_100HZ_ZL_MOFR_FAA_var);                                      
                                            
                                                
                            test_suit    = 0;
                            test_case    = 77;
                            actual_value = ((1/0.0625)-0.0);
                            
                            write("test suit = %d, test case = %d,",test_suit,test_case); 
                                            
                            Request.dlc = 8;                                                     /* CAN Frame DLC */
                            Request.byte(0) = 0x10;                                              /* FF frame */
                            Request.byte(1) = size_dlc;                                          /* Total length of request message -> DID length + SID + DID  = 0B */ 
                            Request.byte(2) = SID_NO;                                            /* SID = 2E */  
                            Request.byte(3) = DID_NO_h;                                          /* DID Number Byte 1 = 0x00 */                        
                            Request.byte(4) = DID_NO_f;                                          /* DID Number Byte 2 = 0x00 */ 
                            Request.byte(5) =  test_suit;                                        /* Test Suite Number  - B0 */
                            Request.byte(6) =  test_case;                                        /* Test Case Number - B1 */
                            Request.byte(7) =  actual_value;                                     /* Test value needed for the test - Min, Mid, Max - B2 */
                                                
                                            
                            output(Request);                                 
                                                
                        }
                        break;
    
            case(78) :                                                                               
    
                    if(flag == 1)                                                        
                        {  
                            flag = 0;
                                                
                            Asmc_100Hz_Zl_Mofr_AlvCtr_var = ((0/1.0)-0.0); 

                            ASMC_100HZ_ZL_MOFR_FAA_var.Asmc_100Hz_Zl_Mofr_AlvCtr =  Asmc_100Hz_Zl_Mofr_AlvCtr_var;  
                            
                            output(ASMC_100HZ_ZL_MOFR_FAA_var);                                      
                                            
                                                
                            test_suit    = 0;
                            test_case    = 78;
                            actual_value = ((0/1.0)-0.0);
                            
                            write("test suit = %d, test case = %d,",test_suit,test_case); 
                                            
                            Request.dlc = 8;                                                     /* CAN Frame DLC */
                            Request.byte(0) = 0x10;                                              /* FF frame */
                            Request.byte(1) = size_dlc;                                          /* Total length of request message -> DID length + SID + DID  = 0B */ 
                            Request.byte(2) = SID_NO;                                            /* SID = 2E */  
                            Request.byte(3) = DID_NO_h;                                          /* DID Number Byte 1 = 0x00 */                        
                            Request.byte(4) = DID_NO_f;                                          /* DID Number Byte 2 = 0x00 */ 
                            Request.byte(5) =  test_suit;                                        /* Test Suite Number  - B0 */
                            Request.byte(6) =  test_case;                                        /* Test Case Number - B1 */
                            Request.byte(7) =  actual_value;                                     /* Test value needed for the test - Min, Mid, Max - B2 */
                                                
                                            
                            output(Request);                                 
                                                
                        }
                        break;
    
            case(79) :                                                                               
    
                    if(flag == 1)                                                        
                        {  
                            flag = 0;
                                                
                            Asmc_100Hz_Zl_Mofr_AlvCtr_var = ((7/1.0)-0.0); 

                            ASMC_100HZ_ZL_MOFR_FAA_var.Asmc_100Hz_Zl_Mofr_AlvCtr =  Asmc_100Hz_Zl_Mofr_AlvCtr_var;  
                            
                            output(ASMC_100HZ_ZL_MOFR_FAA_var);                                      
                                            
                                                
                            test_suit    = 0;
                            test_case    = 79;
                            actual_value = ((7/1.0)-0.0);
                            
                            write("test suit = %d, test case = %d,",test_suit,test_case); 
                                            
                            Request.dlc = 8;                                                     /* CAN Frame DLC */
                            Request.byte(0) = 0x10;                                              /* FF frame */
                            Request.byte(1) = size_dlc;                                          /* Total length of request message -> DID length + SID + DID  = 0B */ 
                            Request.byte(2) = SID_NO;                                            /* SID = 2E */  
                            Request.byte(3) = DID_NO_h;                                          /* DID Number Byte 1 = 0x00 */                        
                            Request.byte(4) = DID_NO_f;                                          /* DID Number Byte 2 = 0x00 */ 
                            Request.byte(5) =  test_suit;                                        /* Test Suite Number  - B0 */
                            Request.byte(6) =  test_case;                                        /* Test Case Number - B1 */
                            Request.byte(7) =  actual_value;                                     /* Test value needed for the test - Min, Mid, Max - B2 */
                                                
                                            
                            output(Request);                                 
                                                
                        }
                        break;
    
            case(80) :                                                                               
    
                    if(flag == 1)                                                        
                        {  
                            flag = 0;
                                                
                            Asmc_100Hz_Zl_Mofr_AlvCtr_var = ((14/1.0)-0.0); 

                            ASMC_100HZ_ZL_MOFR_FAA_var.Asmc_100Hz_Zl_Mofr_AlvCtr =  Asmc_100Hz_Zl_Mofr_AlvCtr_var;  
                            
                            output(ASMC_100HZ_ZL_MOFR_FAA_var);                                      
                                            
                                                
                            test_suit    = 0;
                            test_case    = 80;
                            actual_value = ((14/1.0)-0.0);
                            
                            write("test suit = %d, test case = %d,",test_suit,test_case); 
                                            
                            Request.dlc = 8;                                                     /* CAN Frame DLC */
                            Request.byte(0) = 0x10;                                              /* FF frame */
                            Request.byte(1) = size_dlc;                                          /* Total length of request message -> DID length + SID + DID  = 0B */ 
                            Request.byte(2) = SID_NO;                                            /* SID = 2E */  
                            Request.byte(3) = DID_NO_h;                                          /* DID Number Byte 1 = 0x00 */                        
                            Request.byte(4) = DID_NO_f;                                          /* DID Number Byte 2 = 0x00 */ 
                            Request.byte(5) =  test_suit;                                        /* Test Suite Number  - B0 */
                            Request.byte(6) =  test_case;                                        /* Test Case Number - B1 */
                            Request.byte(7) =  actual_value;                                     /* Test value needed for the test - Min, Mid, Max - B2 */
                                                
                                            
                            output(Request);                                 
                                                
                        }
                        break;
    
                }
        
} 

}
else
{
write(" test suit E-N-D"); 
writeToLog("test suit E-N-D");
cancelTimer(_timercheck);              /* To stop timer (break loop) -> after Complete all test cases.*/

}

}
    
/*_______________________________________ Diagnostics resopnse__________________________________________________*/

on message `UDS_RESP_FAA_FL
{ 

write(" Response  Received" );

if(this.byte(0) == 0x30)
{
    
    
    
    Request.dlc = 8;
    Request.byte(0) = 0x21;   
    Request.byte(1) = 0x03;
    Request.byte(2) = 0x04;
    Request.byte(3) = 0x05;                           
    Request.byte(4) = 0x06;
    Request.byte(5) = 0x07;
    Request.byte(6) = 0x00;
    Request.byte(7) = 0x00;
    
    output(Request); 
    write("Complete Request send" );
    
}

else 
{
    write(" complete Request  not send " );
}



/*_______________________________________ Positive__response__________________________________________________*/


if (((this.byte(1) == 0x6E)&&(this.byte(2) == 0x02))&&((this.byte(3) == 0x00)&&(this.byte(0) == 0x3)))
    
{
    flag = 1;        /* Indication for response received */
    j    = j+2;      /* Inc. for next test suit and test case */
    write(" Positive response");
    writeToLog("test suit = %d,test case = %d ,response = Positive",test_suit ,test_case ); /*Write to log file( which is .csv file)*/ 
}



/*_______________________________________ Negative__response__________________________________________________*/


    if (((this.byte(1) == 0x7F)&&(this.byte(2) == 0x2E))&&((this.byte(3) == 0x22)&&(this.byte(0) == 0x3)))
{
    
    
    flag = 1;
    j    = j+2;
    write("  Negative response ");
    writeToLog("test suit = %d,test case = %d ,response = Negative ",test_suit, test_case );
}



/*_______________________________________ Response_other than +ve 0r -ve__________________________________________________*/

    
if (((this.byte(1) == 0x7F)&&(this.byte(2) == 0x2E))&&((this.byte(3) == 0x10)&&(this.byte(0) == 0x3)))
{
    
    
    flag = 1;
    j    = j+2;
    write(" Din't respond with pass or fail status ");
    writeToLog("test suit = %d,test case = %d ,response = test couldn't be completed as the ecu dint respond with pass or fail status",test_suit, test_case );
}



}

    